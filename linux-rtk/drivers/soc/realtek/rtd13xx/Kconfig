## linux-rtk/drivers/soc/realtek/rtd13xx/Kconfig
```kconfig
menu "RTD13xx General Setup"

config RTK_PSCI_BOOT
	bool "RTK PSCI boot method"
	default n
	help
	  Using PSCI method to control slave CPU power.

config RTK_MMIO_SECURE_RTD13XX_GENERIC_CRT
	bool
	select RTK_MMIO_SECURE

endmenu #RTD13xx general setup

menu "RTD13xx Device Drivers"

source "drivers/soc/realtek/rtd13xx/rtk_ve/Kconfig"

endmenu #RTD13xx Device Drivers
```

## linux-rtk/drivers/soc/realtek/rtd16xx/Kconfig
```kconfig
menu "RTD16xx General Setup"

config THOR_PM_WORKARURD
	bool "System restart workarurd"
	depends on RTK_WATCHDOG
	help
	  For SQA test.

config RTK_PSCI_BOOT
	bool "RTK PSCI boot method"
	default n
	help
	  Using PSCI method to control slave CPU power.

config RTK_MMIO_SECURE_RTD16XX_GENERIC_CRT
	bool
	select RTK_MMIO_SECURE

endmenu #RTD16xx general setup

menu "RTD16xx Device Drivers"

source "drivers/soc/realtek/rtd16xx/rtk_ve/Kconfig"

endmenu #RTD16xx Device Drivers
```

## linux-rtk/drivers/soc/realtek/xen/Kconfig
```kconfig
comment "RealTek XEN support features"

menu "Realtek XEN Features"

config RTK_XEN_HYPERCALL
	bool "Realtek XEN hypercall interface"
	depends on RTK_XEN_SUPPORT
	default y
	help
	  Interface for RTK xen hypercall

config RTK_XEN_SK_RMEM_BASE
	hex "Socket rbuff-memory base"
	depends on RTK_XEN_SUPPORT
	default 0x00100000
	help
	  Base size used for socket receive-buffer.

endmenu #RTD1295 Device Drivers
```

## linux-rtk/drivers/staging/media/rtk-cec/Kconfig
```kconfig
config RTK_HDMI_CEC
       tristate "Realtek HDMI CEC driver"
       depends on MEDIA_CEC
       ---help---
         This is a driver for Realtek HDMI CEC interface. It uses the
         generic CEC framework interface.
         CEC bus is present in the HDMI connector and enables communication
         between compatible devices.
```

## linux-rtk/drivers/thermal/realtek/Kconfig
```kconfig
config RTK_THERMAL
	bool "Realtek thermal management"
	depends on OF && THERMAL_OF
	help
	  Enable thermal management with a generic thermal
	  sensor driver on Realtek SoCs.

	  If you want this support, you should say Y here.

config RTK_THERMAL_EOH
	bool "Realtek thermal sensor EOH"
	depends on RTK_THERMAL

config RTK_THERMAL_RTD119X
	bool "RTD-119X thermal sensor support"
	depends on ARCH_RTD119X
	default y
	select RTK_THERMAL

config RTK_THERMAL_RTD129X
	bool "RTD-129x thermal sensor support"
	depends on ARCH_RTD129x
	default y
	select RTK_THERMAL

config RTK_THERMAL_RTD139X
	bool "RTD-139x thermal sensor support"
	depends on ARCH_RTD139x
	default y
	select RTK_THERMAL

config RTK_THERMAL_RTD16XX
	bool "RTD-16XX thermal sensor support"
	depends on ARCH_RTD16xx
	default y
	select RTK_THERMAL

config RTK_THERMAL_RTD13XX
	bool "RTD-13XX thermal sensor support"
	depends on ARCH_RTD13xx
	default y
	select RTK_THERMAL
```

## linux-rtk/drivers/tsio/Kconfig
```kconfig
menu "TSIO Smart Card Support"

config TSIO
	bool "tsio function"
	default n
	help
	    Support tsio smart card.

endmenu
```

## u-boot-rt/arch/arm/cpu/armv8/Kconfig
```kconfig
if ARM64

config ARMV8_MULTIENTRY
        boolean "Enable multiple CPUs to enter into U-boot"

endif

config RTK_XEN_MONITOR_SUPPORT
	boolean "RTK XEN-Monitor mode support"
	depends on TARGET_RTD1295
	default n
	help
	  REALTEK XEN EL3 Monitor mode support. Turn on this
	  configuration so XEN could perform initialization
	  for the 1st time when startup.

config RTK_SLAVE_CPU_BOOT
	boolean "RTK support for slave cpu boot into uboot"
	depends on TARGET_RTD1295 || TARGET_RTD1395
	select ARMV8_MULTIENTRY
	default n
	help
	  Support for RealTek platform slave CPU boot into uboot.

config POWER_DOWN_S5
	bool "Enter S5 stage at bootcode stage"
	depends on TARGET_RTD1295
	default n
	help
	  This config will enable SOC to enter S5
	  stage at bootcode.
```

## u-boot-rt/drivers/mmc/Kconfig
```kconfig
menu "MMC Host controller Support"

config SH_SDHI
	bool "SuperH/Renesas ARM SoCs on-chip SDHI host controller support"
	depends on RMOBILE
	help
	  Support for the on-chip SDHI host controller on SuperH/Renesas ARM SoCs platform
	  
config RTK_MMC_DRIVER
	bool "open and build the RTK_MMC"
	help
	  Support for the build the RTK EMMC

config RTK_SD_DRIVER
	bool "open and build the RTK_SD"
	help
	  Support for the build the RTK SD

endmenu
```

## u-boot-rt/drivers/rtc/Kconfig
```kconfig
config DM_RTC
	bool "Enable Driver Model for RTC drivers"
	depends on DM
	help
	  Enable drver model for real-time-clock drivers. The RTC uclass
	  then provides the rtc_get()/rtc_set() interface, delegating to
	  drivers to perform the actual functions. See rtc.h for a
	  description of the API.

config RTC_RTD1295
	bool "Enable Realtek RTD1295 RTC driver"
	help
	  This config turns on RTC driver in uboot.

config RTK_RTC_BASE_YEAR
	int "RTC timer base year"
	default 2016
	depends on RTC_RTD1295
	help
	  Start Year of RTK RTC Timer.
```

## u-boot-rtk/board/realtek/Kconfig
```kconfig
menu "RealTek Board Type"
	depends on TARGET_RTD1295 || TARGET_RTD1395 || TARGET_RTD1395_V7 || TARGET_RTD161x

choice
	prompt "Board Type Select"

config BOARD_FPGA
	bool "FPGA Board"

config BOARD_QA
	bool "QA Board"

endchoice
endmenu

config NAS_ENABLE
	bool "NAS version Feature"

if TARGET_RTD1295

config SYS_VENDOR
	default "realtek"

config SYS_SOC
	default "rtd1295"

config SYS_BOARD
	default "1295_fpga" if BOARD_FPGA
	default "1295_qa" if BOARD_QA

config SYS_CONFIG_NAME
	string "Definition of flash type"
	default "rtd1295_fpga" if BOARD_FPGA
	default "rtd1295_qa_emmc_64" if BOARD_QA


endif #TARGET_RTD1295

if TARGET_RTD1395

config SYS_VENDOR
	default "realtek"

config SYS_SOC
	default "rtd1395"

config SYS_BOARD
	default "1395_fpga" if BOARD_FPGA
	default "1395_qa" if BOARD_QA

config SYS_CONFIG_NAME
	string "Definition of different boot flow"
	default "rtd1395_fpga" if BOARD_FPGA
	default "rtd1395_qa_emmc" if BOARD_QA


endif #TARGET_RTD1395

if TARGET_RTD1395_V7

config SYS_VENDOR
	default "realtek"

config SYS_SOC
	default "rtd1395"

config SYS_BOARD
	default "1395_qa_v7" if BOARD_QA

config SYS_CONFIG_NAME
	string "Definition of different boot flow"
	default "rtd1395_qa_v7_emmc" if BOARD_QA


endif #TARGET_RTD1395_V7


if TARGET_RTD161x

config SYS_VENDOR
	default "realtek"
	
config SYS_SOC
	default "rtd161x"
	
config SYS_BOARD
	default "161x_fpga" if BOARD_FPGA
	default "161x_qa" if BOARD_QA
	
config SYS_CONFIG_NAME
	string "Definition of different boot flow"
	default "rtd161x_fpga" if BOARD_FPGA
	default "rtd161x_qa_emmc" if BOARD_QA

endif #TARGET_RTD161x
```

## u-boot-rtk/drivers/lsadc/Kconfig
```kconfig
config RTK_LSADC
	bool "Realtek LSADC support"
	default n
	help
	  Support Realtek LSADC driver

	  Say Y, if you want to enable LSADC feature on Realtek platform.
```

## u-boot-rtk/lib/Kconfig
```kconfig
menu "Library routines"

config CC_OPTIMIZE_LIBS_FOR_SPEED
	bool "Optimize libraries for speed"
	help
	  Enabling this option will pass "-O2" to gcc when compiling
	  under "lib" directory.

	  If unsure, say N.

config HAVE_PRIVATE_LIBGCC
	bool

config USE_PRIVATE_LIBGCC
	bool "Use private libgcc"
	depends on HAVE_PRIVATE_LIBGCC
	help
	  This option allows you to use the built-in libgcc implementation
	  of U-boot instead of the one privided by the compiler.
	  If unsure, say N.

config SYS_HZ
	int
	default 1000
	help
	  The frequency of the timer returned by get_timer().
	  get_timer() must operate in milliseconds and this option must be
	  set to 1000.

config SYS_VSNPRINTF
	bool "Enable safe version of sprintf()"
	help
	  Since sprintf() can overflow its buffer, it is common to use
	  snprintf() instead, which knows the buffer size and can avoid
	  overflow. However, this does increase code size slightly (for
	  Thumb-2, about 420 bytes). Enable this option for safety when
	  using sprintf() with data you do not control.

config REGEX
	bool "Enable regular expression support"
	default y if NET
	help
	  If this variable is defined, U-Boot is linked against the
	  SLRE (Super Light Regular Expression) library, which adds
	  regex support to some commands, for example "env grep" and
	  "setexpr".

config LIB_RAND
	bool "Pseudo-random library support "
	help
	  This library provides pseudo-random number generator functions.

source lib/rsa/Kconfig

menu "Android Verified Boot"

config LIBAVB
	bool "Android Verified Boot 2.0 support"
	depends on ANDROID_BOOT_IMAGE
	default n
	help
	  This enables support of Android Verified Boot 2.0 which can be used
	  to assure the end user of the integrity of the software running on a
	  device. Introduces such features as boot chain of trust, rollback
	  protection etc.

endmenu

menu "Hashing Support"

config SHA1
	bool "Enable SHA1 support"
	help
	  This option enables support of hashing using SHA1 algorithm.
	  The hash is calculated in software.
	  The SHA1 algorithm produces a 160-bit (20-byte) hash value
	  (digest).

config SHA256
	bool "Enable SHA256 support"
	help
	  This option enables support of hashing using SHA256 algorithm.
	  The hash is calculated in software.
	  The SHA256 algorithm produces a 256-bit (32-byte) hash value
	  (digest).

config SHA_HW_ACCEL
	bool "Enable hashing using hardware"
	help
	  This option enables hardware acceleration
	  for SHA1/SHA256 hashing.
	  This affects the 'hash' command and also the
	  hash_lookup_algo() function.

config SHA_PROG_HW_ACCEL
	bool "Enable Progressive hashing support using hardware"
	depends on SHA_HW_ACCEL
	help
	  This option enables hardware-acceleration for
	  SHA1/SHA256 progressive hashing.
	  Data can be streamed in a block at a time and the hashing
	  is performed in hardware.
endmenu

config ERRNO_STR
	bool "Enable function for getting errno-related string message"
	help
	  The function errno_str(int errno), returns a pointer to the errno
	  corresponding text message:
	  - if errno is null or positive number - a pointer to "Success" message
	  - if errno is negative - a pointer to errno related message
	  
config OF_LIBFDT
	bool "Enable the FDT library"
	default y if OF_CONTROL
	help
	  This enables the FDT library (libfdt). It provides functions for
	  accessing binary device tree images in memory, such as adding and
	  removing nodes and properties, scanning through the tree and finding
	  particular compatible nodes. The library operates on a flattened
	  version of the device tree.

config OF_LIBFDT_OVERLAY
	bool "Enable the FDT library overlay support"
	help
	  This enables the FDT library (libfdt) overlay support.

config SPL_OF_LIBFDT
	bool "Enable the FDT library for SPL"
	default y if SPL_OF_CONTROL
	help
	  This enables the FDT library (libfdt). It provides functions for
	  accessing binary device tree images in memory, such as adding and
	  removing nodes and properties, scanning through the tree and finding
	  particular compatible nodes. The library operates on a flattened
	  version of the device tree.

config FDT_FIXUP_PARTITIONS
	bool "overwrite MTD partitions in DTS through defined in 'mtdparts'"
	depends on OF_LIBFDT
	default n
	help
	  Allow overwriting defined partitions in the device tree blob
	  using partition info defined in the 'mtdparts' environment
	  variable.

config FASTBOOT_RTK
	bool "Enable rtk fastboot support"
	help
	 Enable realtek fastboot support

endmenu
```
