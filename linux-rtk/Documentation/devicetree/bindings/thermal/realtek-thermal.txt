## linux-rtk/Documentation/devicetree/bindings/thermal/realtek-thermal.txt
```
Realtek Thermal Sensor 
======================

* Sensor node
-------------
Required properties :
- compatible : shall contain one of the following :
	"realtek,rtd119x-thermal-sensor",
	"realtek,rtd129x-thermal-sensor",
	"realtek,rtd139x-thermal-sensor",
	"realtek,rtd16xx-thermal-sensor",
	"realtek,rtd13xx-thermal-sensor".

- #thermal-sensor-cells : shall contain 0.

Optional properties:
- eoh-restore-ms: shall contain a interger, lock-freq time in ms for eoh,
	only vaild if eoh configured.

See also 'Documentation/devicetree/bindings/thermal/thermal.txt'

Exmaple :
	cpu-tsensor {
		tible = "realtek,rtd129x-thermal-sensor";
		reg = <0x9801D150 0x1C>;
		#thermal-sensor-cells = <0>;
		
		status = "okay";
	};
```

## linux-rtk/Documentation/devicetree/bindings/watchdog/rtk-wdt.txt
```
Realtek  watchdog timer

Required properties:
- compatible : should be "realtek,rtk-watchdog"
- reg : specifies base physical address and size of the registers
- timeout-sec: contains the watchdog timeout in seconds

Example:
watchdog@0x10000000 {
	compatible = "realtek,rtk-watchdog";
	reg = <0x10000000 0x100>;
	timeout-sec = <20>;
};
```

## linux-rtk/arch/arm/mach-rtd119x/Kconfig
```kconfig
config ARCH_RTD119X
	bool "Realtek RTD119x family"
	depends on ARCH_MULTI_V7
	select ARM_AMBA
	select CLKDEV_LOOKUP
	select CPU_V7
	select HAVE_SMP
	select HAVE_MACH_CLKDEV
	select GENERIC_CLOCKEVENTS
	select NEED_MACH_MEMORY_H
	select ZONE_DMA
	select HAVE_SCHED_CLOCK
	select ARCH_HAS_CPUFREQ
	select CLKSRC_OF
	select ARCH_REQUIRE_GPIOLIB
	select GENERIC_IRQ_CHIP
	select IRQ_DOMAIN
	select PINCTRL
	select COMMON_CLK
	select ARCH_HAS_BARRIERS
	select SPARSE_IRQ
	select RTK_PLATFORM
	select PM_OPP
	help
	  Support for Realtek RTD119x family.
```

## linux-rtk/arch/arm/mach-rtd139x/Kconfig
```kconfig
config ARCH_RTD139x
	bool "Realtek RTD139x family"
	select ARM_AMBA
	select CPU_32v8
	select ARM_GIC
	select ARM_GLOBAL_TIMER
	select CLKDEV_LOOKUP
	select CPU_V7
	select HAVE_SMP
	select HAVE_MACH_CLKDEV
	select GENERIC_CLOCKEVENTS
	select ZONE_DMA
	select HAVE_SCHED_CLOCK
	select ARCH_HAS_CPUFREQ
	select CLKSRC_OF
	select ARCH_REQUIRE_GPIOLIB
	select GENERIC_IRQ_CHIP
	select IRQ_DOMAIN
	select PINCTRL
	select COMMON_CLK
	select ARCH_HAS_BARRIERS
	select SPARSE_IRQ
	select RTK_PLATFORM
	select PM_OPP
	select ARM_HAS_SG_CHAIN
	select ARM_PATCH_PHYS_VIRT
	select AUTO_ZRELADDR
	select MIGHT_HAVE_PCI
	select MULTI_IRQ_HANDLER
	select PCI_DOMAINS if PCI
	select USE_OF
	help
	  Support for Realtek RTD139x Platform
```

## linux-rtk/arch/arm/mach-rtd16xx/Kconfig
```kconfig
config ARCH_RTD16xx
	bool "Realtek RTD16xx family"
	select ARM_AMBA
	select CPU_32v8
	select ARM_GIC
	select ARM_GIC_V3
	select ARM_PSCI
	select ARM_GLOBAL_TIMER
	select CLKDEV_LOOKUP
	select CPU_V7
	select HAVE_SMP
	select HAVE_MACH_CLKDEV
	select GENERIC_CLOCKEVENTS
	select ZONE_DMA
	select HAVE_SCHED_CLOCK
	select ARCH_HAS_CPUFREQ
	select CLKSRC_OF
	select ARCH_REQUIRE_GPIOLIB
	select GENERIC_IRQ_CHIP
	select IRQ_DOMAIN
	select PINCTRL
	select COMMON_CLK
	select ARCH_HAS_BARRIERS
	select SPARSE_IRQ
	select RTK_PLATFORM
	select RTK_PLATFORM_PSCI
	select PM_OPP
	select ARM_HAS_SG_CHAIN
	select ARM_PATCH_PHYS_VIRT
	select AUTO_ZRELADDR
	select MIGHT_HAVE_PCI
	select MULTI_IRQ_HANDLER
	select PCI_DOMAINS if PCI
	select USE_OF
	select ARM_GIC_V3_DEBUGFS
	help
	  Support for Realtek RTD16xx Platform
```

## linux-rtk/drivers/bluetooth/rtk_btusb/Kconfig
```kconfig
config BT_HCIUSB_RTK
        tristate "Realtek HCI USB driver for 8723BU, 8821cu and 8822be"
        depends on USB
        help
          Realtek Bluetooth HCI USB driver.
          This driver is required if you want to use Realtek Bluetooth devices with
          USB interface.
           Say Y here to compile support for Realtek Bluetooth USB devices into the
          kernel or say M to compile it as module (btusb).
```

## linux-rtk/drivers/clk/realtek/Kconfig
```kconfig
config COMMON_CLK_REALTEK
	bool "Clock driver for realtek"
	select RTK_MMIO
	select RESET_CONTROLLER

config CLK_PLL_PSAUD
	bool

config CLK_PLL_DIF
	bool

config RESET_PLATFORM
	bool

config COMMON_CLK_RTD119X
	bool "Clock driver for RTD119x"
	depends on ARCH_RTD119X
	select COMMON_CLK_REALTEK
	default y

config COMMON_CLK_RTD129X
	bool "Clock driver for RTD129x"
	depends on ARCH_RTD129x
	select COMMON_CLK_REALTEK
	default y

config COMMON_CLK_RTD139X
	bool "Clock driver for RTD139x"
	depends on ARCH_RTD139x
	select COMMON_CLK_REALTEK
	default y

config COMMON_CLK_RTD16XX
	bool "Clock driver for RTD16xx"
	depends on ARCH_RTD16xx
	select COMMON_CLK_REALTEK
	select CLK_PLL_PSAUD
	select CLK_PLL_DIF
	select RESET_PLATFORM
	select RTK_MMIO_SECURE_RTD16XX_GENERIC_CRT
	default y

config COMMON_CLK_RTD13XX
	bool "Clock driver for RTD13xx"
	depends on ARCH_RTD13xx
	select COMMON_CLK_REALTEK
	select CLK_PLL_PSAUD
	select CLK_PLL_DIF
	select RESET_PLATFORM
	select RTK_MMIO_SECURE_RTD13XX_GENERIC_CRT
	default y

config COMMON_CLK_REALTEK_TEE
	bool "Clock Driver to Control PLL SCPU over TEE"
	depends on TEE
	default n
	help
	  PLL BUS/DCSB would be fixed when enable this.
```

## linux-rtk/drivers/devfreq/realtek/Kconfig
```kconfig
if PM_DEVFREQ

config DEVFREQ_GOV_RTK_LTL
	tristate "Realtek Long-Term Load"
	help
	  LTL governor for Realtek Devfreq Drvier

config RTK_BUS_DEVFREQ
	tristate "Realtek Bus DEVFREQ Driver"
	select DEVFREQ_GOV_SIMPLE_ONDEMAND
	select DEVFREQ_GOV_PASSIVE
	select DEVFREQ_GOV_RTK_LTL
	select PM_DEVFREQ_EVENT
	select PM_OPP
	help
	  This adds the DEVFREQ driver for Realtek Bus

config DEVFREQ_EVENT_RTK_BANDWIDTH
	tristate "Realtek Bandwidth event Driver"
	help
	  Realtek Bandwidth event Driver

endif # PM_DEVFREQ
```

## linux-rtk/drivers/media/platform/rtk_cec/Kconfig
```kconfig
#Copyright (C) 2007-2013 Realtek Semiconductor Corporation.
# drivers/Kconfig

menu "CEC Support"

config XEN_CECDEV_FRONTEND
    bool "CEC Xen frontend driver support"
    depends on XEN
    select XEN_XENBUS_FRONTEND
    default n
    help
        This driver implements the front-end of the Xen virtual cec device driver.
        It communicates with a back-end driver in another domain which drives the actual
        cec device.

config CEC
	bool "CEC Support"

config XEN_CECDEV_BACKEND
    bool "CEC Xen backend driver support"
    depends on XEN
	default n
    help
        The regulator-device backend driver allows the kernel to export its
        regulator devices to other guests via a high-performance shared-memory
        interface.

menu "CEC Adapters"
	depends on CEC

config RTK_CEC
	tristate "CEC Controller for Realtek platform"
	depends on CEC
	default n
	help
	  Say Y, if you want to enable CEC feature on Realtek platform.

endmenu
endmenu
```

## linux-rtk/drivers/media/platform/rtk_dptx/Kconfig
```kconfig
#Copyright (C) 2007-2013 Realtek Semiconductor Corporation.
# drivers/Kconfig

config RTK_DPTX
	bool "RTK Display Port Support"
```

## linux-rtk/drivers/media/platform/rtk_hdmitx/Kconfig
```kconfig
#Copyright (C) 2017 Realtek Semiconductor Corporation

config RTK_HDMITX
	tristate "HDMITX for Realtek RTD1295 platform"
	select I2C
	select SWITCH
    select RTK_RPC
	default n
	help
	  Say Y, if you want to enable HDMITX feature on Realtek RTD1295 platform.
```

## linux-rtk/drivers/perf/Kconfig
```kconfig
#
# Performance Monitor Drivers
#

menu "Performance monitor support"

config ARM_PMU
	depends on PERF_EVENTS && (ARM || ARM64)
	bool "ARM PMU framework"
	default y
	help
	  Say y if you want to use CPU performance monitors on ARM-based
	  systems.

config ARM_PMUV3
	depends on HW_PERF_EVENTS && ((ARM && CPU_V7) || ARM64)
	bool "ARM PMUv3 support" if !ARM64
	default ARM64
	help
	  Say y if you want to use CPU performance monitors on ARMv8
	  systems that implement the PMUv3 architecture.

config XGENE_PMU
        depends on PERF_EVENTS && ARCH_XGENE
        bool "APM X-Gene SoC PMU"
        default n
        help
          Say y if you want to use APM X-Gene SoC performance monitors.

endmenu
```

## linux-rtk/drivers/smartcard/adapter/Kconfig
```kconfig
# drivers/Kconfig

comment"Smart Card Interface"
	depends on SMARTCARD

config MARS_SMARTCARD_IFD
	tristate "Smart Card Interface for Saturn(1886 only), Darwin, Macarthur & Nike"
	depends on SMARTCARD && (REALTEK_SATURN || REALTEK_DARWIN || REALTEK_MACARTHUR || REALTEK_NIKE)
	default n
	help
	  If you want to use smart card on Saturn, Darwin and Macarthur board, say Y.

config GPIO_SMARTCARD_IFD
	tristate "GPIO Smart Card Interface"
	depends on SMARTCARD && REALTEK_DMP_VENUS
	select REALTEK_PWM
	default n
	help
	  If you want to use gpio based smart card on board, say Y.

config ICAM_SMARTCARD_IFD
	tristate "ICAM Smart Card Interface for Nike"
	depends on SMARTCARD && (REALTEK_NIKE)
	default n
	help
	  If you want to use ICAM smart card interface on Nike platform, say Y.
```

## linux-rtk/drivers/soc/realtek/common/Kconfig
```kconfig
config RTK_SB2_SECURITY_DEBG
	bool "Realtek system bridge security mode debug"
	depends on HAVE_ARM_SMCCC
	default n
	help
	  Enable helper functions for Realtek system bridge security mode debug. If unsure, say N.

config RTK_RBUS_BARRIER
	bool "Realtek rbus barrier"
	depends on RTK_MEM_REMAP && (ARCH_RTD119X || ARCH_RTD129x || ARCH_RTD139x)
	default y
	help
	  Enable helper functions for R-bus barrier. If unsure, say N.

config RTK_MEM_REMAP
	bool "Realtek memory remap"
	default y
	help
	  Enable helper functions for static ioremap. If unsure, say N.

config RTK_ACPU_RELOAD
	bool "Realtek dynamic ACPU reload"
	default n
	help
	  Dynamic ACPU stop/start mechanism. If unsure, say N.

config RTK_IPCSHM_RESET
	bool "Dynamic IPC share memory reset"
	depends on RTK_ACPU_RELOAD
	default n
	help
	  Reset IPC_SHM when performing dynamic ACPU stop/start. If unsure, say N.

config RTK_REGMAP_I2C
	bool
	select REGMAP

config RTK_REGMAP_MMIO
	bool
	select REGMAP

config RTK_REGMAP_SECURE_MMIO
	bool
	select RTK_REGMAP_MMIO
	depends on HAVE_ARM_SMCCC

config RTK_MMIO
	bool
	select REGMAP_MMIO

config RTK_MMIO_SECURE
	bool
	select RTK_MMIO
	select RTK_REGMAP_SECURE_MMIO

config RTK_MCP
	bool "Realtek MCP driver"
	default n
	help
	  Realtek MCP driver

config RTK_VMX_ULTRA
	bool "VMX ultra boot enable"
	default n
	select RTK_VMX_DRM
        select DM_VERITY_FEC
	help
	  Set VMX ultra boot enable.

config RTK_VMX_ULTRA_RAMFS_VENDOR
	bool "VMX ultra boot enable ramfs vendor"
	default n
	help
	  Set VMX ultra ramfs vendor enable.

config RTK_VMX_DRM
	bool "VMX DRM"
	default n
	help
	  Enable VMX DRM.

config RTK_DEMOD
	tristate "Realtek Demod Device Driver"
	default y
	depends on ARCH_RTD16xx
	help
	  This driver provides PM and userspace driver interface of Demod.

config RTK_TP
	tristate "Realtek TP Device Driver"
	default y
	depends on ARCH_RTD16xx
	help
	  This driver provides PM and userspace driver interface of TP.

config RTK_R2RDSC
	tristate "Realtek R2RDSC Device Driver"
	default y
	depends on ARCH_RTD16xx
	help
	  This driver provides PM and userspace driver interface of R2RDSC.

config RTK_DCSYS
	tristate "Realtek DCSYS Device Drviver"
	depends on RTK_PERFCNT
	help
	  This driver provides support of multiple comsumers for using PC.

config RTK_DMC
	tristate "Realtek DMC Device Driver"
	depends on RTK_PERFCNT
	help
	  This driver provides support of multiple comsumers for using PC,
	  and safty DMC register access.

config RTK_AVCPU_LOG
	bool "Realtek AVCPU share memory logging system"
	depends on RTK_RPC
	help
	  Enable AVCPU share memory logging read from userspace
	  via device node.

config RTK_USB_CTRL_MANAGER
	tristate "RTK Multiple USB Host/Device Controller Manager"
	default y if USB_OHCI_RTK || USB_EHCI_RTK || USB_DWC3_RTK
	---help---
	  The Realtek chips are Multiple host/peripheral USB controllers.
	  Enable the driver to control clock, reset and usb power gpio.

source "drivers/soc/realtek/common/Kconfig.workaround"
source "drivers/soc/realtek/common/rpc/Kconfig"
source "drivers/soc/realtek/common/pwrctrl/Kconfig"
source "drivers/soc/realtek/common/hse/Kconfig"
source "drivers/soc/realtek/common/debug/Kconfig"
source "drivers/soc/realtek/common/dvfs/Kconfig"
source "drivers/soc/realtek/common/perfcnt/Kconfig"
source "drivers/soc/realtek/common/info/Kconfig"
source "drivers/soc/realtek/common/buflock/Kconfig"
```

## linux-rtk/drivers/soc/realtek/common/Kconfig.workaround
```kconfig
config RTK_WORKAROUND_MALI_UTGARD_PM_RUNTIME_KEEP_ON
	bool
	depends on ARCH_RTD139x
	default y
```

## linux-rtk/drivers/soc/realtek/common/buflock/Kconfig
```kconfig
config RTK_BUFLOCK
	bool "Realtek BUFLOCK driver"
	depends on RTK_MEM_REMAP
	default n
	help
	  Realtek BUFLOCK driver
```

## linux-rtk/drivers/soc/realtek/common/debug/Kconfig
```kconfig
config RTK_SRR_READER
	bool "SRR Reader"
	depends on HAVE_ARM_SMCCC
	depends on ARCH_RTD16xx
	depends on DEBUG_FS
	default y
```

## linux-rtk/drivers/soc/realtek/common/dvfs/Kconfig
```kconfig
config RTK_CPU_CACHE_SUPPLY_COORDINATOR
	bool "Realtek CPU cache supply coordinator"
	depends on REGULATOR_G2227
	depends on ARCH_RTD129x
	default y

config RTK_CPU_SUPPLY_ENHANCER
	bool "Realtek CPU supply enhancer"
	depends on ARCH_RTD139x
	default y

config RTK_CPU_HIGH_LOAD_BOOSTER
	bool "Realtek CPU high-load booster"
	default n

config RTK_CPU_VOLT_SEL
	bool "Add OPP prop extn to CPU device"
	default y

config RTK_CPU_VOLT_SEL_CHIP_REV
	bool
	default y if ARCH_RTD139x

config RTK_CPU_VOLT_SEL_DSS
	bool
	default y if ARCH_RTD16xx
```

## linux-rtk/drivers/soc/realtek/common/hse/Kconfig
```kconfig
config RTK_HSE
	bool "Realtek Highspeed Streaming Engine driver"
	default y if ARCH_RTD139x || ARCH_RTD16xx
	help
	  Enable Realtek HSE driver. If unsure, say N.

config RTK_HSE_TESTBUF_EXPORT
	bool "Reserve a testbuf to export"
	default n

config RTK_HSE_SELFTEST
	bool "Realtek Highspeed Streaming Engine driver Selftest"
	default n
	depends on RTK_HSE
	help
	  Self-test after HSE driver ready.

config RTK_HSE_HAS_YUY2
	bool
	default y if RTK_HSE_SELFTEST
	depends on RTK_HSE
	depends on ARCH_RTD16xx || ARCH_RTD13xx

config RTK_HSE_HAS_ROTATE
	bool
	default y if RTK_HSE_SELFTEST
	depends on RTK_HSE
	depends on ARCH_RTD16xx || ARCH_RTD13xx
```

## linux-rtk/drivers/soc/realtek/common/info/Kconfig
```kconfig
config RTK_INFO_PLL
	bool "add DebugFs for PLL info"
	depends on ARCH_RTD139x || ARCH_RTD16xx || ARCH_RTD13xx
	default y
```

## linux-rtk/drivers/soc/realtek/common/perfcnt/Kconfig
```kconfig
config RTK_PERFCNT
	bool "Realtek performance counter"
	help
	  provides a simple interface to use performance count
```
