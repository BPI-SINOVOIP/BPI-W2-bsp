## linux-rt/Documentation/devicetree/bindings/cpufreq/cpufreq-rtk.txt
```
Realtek CPU Driver DT-bindings
==============================

DVFS node (platform device node)
-------------------------------

Required properties :
- compatible : shall contain only any of the following:
	"realtek,rtd129x-dvfs",
	"realtek,rtd139x-dvfs",
	"realtek,cpu-dvfs",
	"realtek,dummy-dvfs".

Optional properties:

The properties below are not supported by the dummy cpufreq driver.

- cpu-supply : shall contain a phandle of a regulator for CPU, used by dynamic
	opmode.

- l2-supply : shall contain a phandle of a regulator for L2 cache, used by
	cache voltage adjusting.

- auto-boost-enable : boolean to specify if auto boost shall be enabled.

- auto-boost-ms : shall contain a integer in ms, enable time of auto boost,
	only valid when 'auto-boost-enable' configured.

CPU node
--------

When using the dummy cpufreq driver, please put the following properties in the DVFS node.

- OPP binding:
  See also 'Documentation/devicetree/bindings/opp/opp.txt'

  Only support for operating-points-v2.

- CPU Cooling Dev binding (optional):
  See also 'Documentation/devicetree/bindings/thermal/thermal.txt'

- CLOCK binding:
  See also 'Documentation/devicetree/bindings/regulator/cpu.txt'

- REGULATOR binding (optional):
  See also 'Documentation/devicetree/bindings/regulator/regulator.txt'

Exmaple:
	cpus {
		cpu@0 {
			clocks = <&cc CC_PLL_SCPU>;
                        cpu-supply = <&cpu_supp>;
			operating-points-v2 = <&cpu_opps>;
			cooling-min-level = <0>;
			cooling-max-level = <11>;
			#cooling-cells = <2>; /* min followed by max */
		};
	};

	cpu_opps: opp-table-0 {
		...
	};

	dvfs {
		compatible = "realtek,rtk129x-dvfs";
		l2-supply = <&mem_supp>;
	};
```

## linux-rt/Documentation/devicetree/bindings/nvmem/rtk-efuse.txt
```
Realtek eFuse DT-bindings
=========================

See also 'Documentation/devicetree/bindings/nvmem/nvmem.txt'

Requried properties :
- compatible : shall contain the following :
	"realtek,efuse".

- nvmem-cells & nvmem-cell-names : efuse data for display in sysfs.
```

## linux-rt/Documentation/devicetree/bindings/regulator/sy8827e-regulator.txt
```
Binding for Silergy-SY8827E Regulator
=====================================

Required Properties:

* reg : shall contains an i2c address.

* compatible : shall contains "silergy,sy8827e".

Optional properties:

Generic Regulator properties (See regulator.txt)
```

## linux-rt/Documentation/devicetree/bindings/reset/realtek,reset.txt
```
Realtek Reset Controller
========================

---------------------------
MMIO-based Reset Controller
---------------------------

Required properties :
- compatible : shall contain:
	"realtek,reset-controller"

- #reset-cells: shall contain 1

- realtek,mmio: shall contain a phandle to mmio node and an offset.

Optional properties :

- async-group: contains an unsigned int. Only the groups with the same id,
	will be triggered when do_sync.

- no-pm: ingore the pm callbacks.

- boot-clear-bits : contains an unsigned int. A bit mask, which
        the register value will be clear.

- pm-ignore-bits: contains an unsigned int. A bit mask to tell which bits
	shall be ignored when restoring register value in pm callbacks.

- has-write-en: : an empty property which indicates the controlller to setup the reset bit with
	using write-en bit located in (reset_bit+1). (for Thor)

Example: 
	asr1: async-soft-reset@98000000 {
		compatible = "realtek,reset-controller";
		reg = <0x98000000 0x4>;
		realtek,mmio = <&crt_mmio 0x0>;
		#reset-cells = <1>;

		async-group = <0>;
		no-pm;
	};

	asr2: async-soft-reset@98000004 {
		compatible = "realtek,reset-controller";
		reg = <0x98000004 0x4>;
		realtek,mmio = <&crt_mmio 0x0>;
		#reset-cells = <1>;

		async-group = <0>;
		no-pm;
	};

	consumer {
		...
		resets = <&asr1 RTK_RSTN_DO_SYNC>,
			<&asr1 0>,
			<&asr2 1>;
	};


----------------------
Reset Control Provider
----------------------
- compatible : shall contain:
	"realtek,reset-control-provider"

Example:
	provider {
		compatible = "realtek,reset-control-provider";
		rst_0 {
			resets = <&asr 0>,  <&asr 1>;
			reset-names = "reset0", "reset1";
		};
		rst_1 {
			resets = <&asr 2>,  <&asr 3>;
			reset-names = "reset2", "reset3";
		};
	};


	use rstc_get("reset0") to get '<&asr 0>';

														 
```

## linux-rt/Documentation/devicetree/bindings/rtc/rtc-rtk.txt
```
Realtek real timer driver

Required properties:
- compatible: must be "realtek,rtk-rtc"
```

## linux-rt/Documentation/devicetree/bindings/soc/realtek,power.txt
```
Realtek Power Control DT-bindings
=================================

NOTE: read section b if platform is rtd-139x, or rtd-16xx

[A. Power Control Manager]

1. Power Control Manager (PCM) Node
-----------------------------------

Required properties :

- compatible : shall contain the followings :
	"realtek,129x-pcm", 
	"realtek,139x-pcm".

- pcm,type : shall conatins a predefined type value as the following :
	PCM_TYPE_NONE,
	PCM_TYPE_MGR,
	PCM_TYPE_GENPD,
	which is defined in 'include/dt-bindings/soc/rtk,pwrctrl.h'.

	if type is PCM_TYPE_NONE, do only initializing power_control.
	if type is PCM_TYPE_MGR, it power_off_unused via power_control_manager.
	if type is PCM_TYPE_GENPD, after power_control is initialized, generic
	power domain will be setup with the power_control. See also
	'Documentation/devicetree/bindings/power/power_domain.txt' for more
	information.

2. Power Control Node
---------------------

A Power Control Node shall be a child node of a PCM Node.

Required properties :

- compatible : shall contain the followings :
	"realtek,pwrctrl", a generic type,
	"realtek,pwrctrl-timer", which wrapper a generic type with timer.

Optional properties :

- realtek,chip-rev,inc : shall contain an array of u32, indicate this node is 
	valid under these chip reversion.

- realtek,chip-rev,exc : shall contain an array of u32, indicate this node is 
	invalid under these chip reversion.

The following properties only works when parent node type is PCM_TYPE_GENPD.

- pd,name : shall contain a string, as the power domain name.

- pd,default-off : if this property is existed, indicate the power domain is
	off when boot.


2-1 Generic Type :

Optional properties :

reg : shall contain register(s) for controlling power.

reg-names : shall contain an array of string. used to map reg with name of 
	a child node .

- clocks : shall contain phandle of required clocks

- resets : shall contain phandle of required reset controls

- pwrctrls : shall contain phandle of required power controls

The following properties only works when parent node type is PCM_TYPE_MGR.

- ref,name : shall contain a string, name of other device node.

- ref,compatible: shall contain a string, compatible of other device node.


2-1-1 Child Nodes :

A child node of generic type is a step of power-on/off flow.

When power-on, do each step in the order of the child nodes. And in reversed
order when doing power off.

Required proerties : 

- pwr,type : shall contain a predefined type value as the following :
	PWRCTRL_TYPE_REG,
	PWRCTRL_TYPE_RESET.

- resets: shall contain phandle of required reset controls, only works when
	pwr,type is PWRCTRL_TYPE_RESET.

	When step into a PWRCTRL_TYPE_RESET node, simply reset all reset controls 
	in the node.

The following properties only works when pwr,type is PWRCTRL_TYPE_REG

- pwr,width : shall contain a integer, width of value.

- pwr,shift : shall contain a integer, shift of value.

- pwr,value-on : shall contain a integer, value to set when power-on.

- pwr,value-off : shall contain a integer, value to set when power-on.

- pwr,value-inv : flag, swap value-on and value-off.

Optional properties :

- pwr,never-on : flag, this step will not be processed when power-on.

- pwr,never-off : flag, this step will not be processed when power-off.

- pwr,no-state : flag, this step will not be processed when checking power-state.


2-2 Timer Type :

Required proerties :

- pwr,expired-time-sec : shall contain a integer, timeout value in second.

- pwerctrl : shall contain a phandle of power control for wrapping.

[B. Power Controller]

- compatible : shall contain the followings :
	"realtek,rtd139x-power-controller",
	"realtek,rtd16xx-power-controller"

- reg : shall contain the base address of io memory. 

- resets : shall contain reset control for internal usage
 
- reset-names = name to indentify the resets above.

- #power-domain-cells - shall contain unsigned int 1.

[C. Power Domain Wrapper]

Wrap a power domain as a power control

- compatible : shall contain the followings :
	"realtek,power-domain-wrapper".
	
```

## linux-rt/Documentation/devicetree/bindings/soc/realtek/dcsys_debug.txt
```
Realtek DC system bus debug
=====================

Required properties:

- compatible : shall contain only the following:
        "realtek,rtk-dcsys-debug".

- reg : hall contain DC system bus configure  address

Example:
	dc_sys_debug@98008000 {
		compatible = "realtek,rtk-dcsys-debug";
		reg = <0x98008000 0x1000>;
		interrupts = <0 35 4>;
		err_cmd_detect = <0x0>, /* Enable over DRAM access detection */
			<0x0>; /* interrupt to CPU */
		mt_0 = <0x0>,  /* NUM0 Enable memory trash detection */
			<0x0>, /* NUM0 start address*/
			<0x0>, /* NUM0 end address*/
			<0x0>, /* NUM0 module ID0*/
			<0x0>, /* NUM0 module ID1*/
			<0x0>, /* NUM0 module ID2*/
			<0x0>, /* NUM0 module ID3*/
			<0x0>, /* NUM0 interrupt to CPU*/
			<0x3>, /* NUM0 access type*/
			<0x0>; /* NUM0 mode*/
		mt_1 = <0x0>, /* NUM1 Enable memory trash detection */
			<0x0>, /* NUM1 start address*/
			<0x0>, /* NUM1 end address*/
			<0x0>, /* NUM1 module ID0*/
			<0x0>, /* NUM1 module ID1*/
			<0x0>, /* NUM1 module ID2*/
			<0x0>, /* NUM1 module ID3*/
			<0x0>, /* NUM1 interrupt to CPU*/
			<0x0>, /* NUM1 access type*/
			<0x0>; /* NUM1 mode*/
		mt_2 = <0x0>, /* NUM2 Enable memory trash detection */
			<0x0>, /* NUM2 start address*/
			<0x0>, /* NUM2 end address*/
			<0x0>, /* NUM2 module ID0*/
			<0x0>, /* NUM2 module ID1*/
			<0x0>, /* NUM2 module ID2*/
			<0x0>, /* NUM2 module ID3*/
			<0x0>, /* NUM2 interrupt to CPU*/
			<0x0>, /* NUM2 access type*/
			<0x0>; /* NUM2 mode*/
		mt_3 = <0x0>,  /* NUM3 Enable memory trash detection */
			<0x0>, /* NUM3 start address*/
			<0x0>, /* NUM3 end address*/
			<0x0>, /* NUM3 module ID0*/
			<0x0>, /* NUM3 module ID1*/
			<0x0>, /* NUM3 module ID2*/
			<0x0>, /* NUM3 module ID3*/
			<0x0>, /* NUM3 interrupt to CPU*/
			<0x0>, /* NUM3 access type*/
			<0x0>; /* NUM3 mode*/
		mt_4 = <0x0>,  /* NUM4 Enable memory trash detection */
			<0x0>, /* NUM4 start address*/
			<0x0>, /* NUM4 end address*/
			<0x0>, /* NUM4 module ID0*/
			<0x0>, /* NUM4 module ID1*/
			<0x0>, /* NUM4 module ID2*/
			<0x0>, /* NUM4 module ID3*/
			<0x0>, /* NUM4 interrupt to CPU*/
			<0x0>, /* NUM4 access type*/
			<0x0>; /* NUM4 mode*/
		mt_5 = <0x0>,  /* NUM5 Enable memory trash detection */
			<0x0>, /* NUM5 start address*/
			<0x0>, /* NUM5 end address*/
			<0x0>, /* NUM5 module ID0*/
			<0x0>, /* NUM5 module ID1*/
			<0x0>, /* NUM5 module ID2*/
			<0x0>, /* NUM5 module ID3*/
			<0x0>, /* NUM5 interrupt to CPU*/
			<0x0>, /* NUM5 access type*/
			<0x0>; /* NUM5 mode*/
		mt_6 = <0x0>,  /* NUM6 Enable memory trash detection */
			<0x0>, /* NUM6 start address*/
			<0x0>, /* NUM6 end address*/
			<0x0>, /* NUM6 module ID0*/
			<0x0>, /* NUM6 module ID1*/
			<0x0>, /* NUM6 module ID2*/
			<0x0>, /* NUM6 module ID3*/
			<0x0>, /* NUM6 interrupt to CPU*/
			<0x0>, /* NUM6 access type*/
			<0x0>; /* NUM6 mode*/
		mt_7 = <0x0>,  /* NUM7 Enable memory trash detection */
			<0x0>, /* NUM7 start address*/
			<0x0>, /* NUM7 end address*/
			<0x0>, /* NUM7 module ID0*/
			<0x0>, /* NUM7 module ID1*/
			<0x0>, /* NUM7 module ID2*/
			<0x0>, /* NUM7 module ID3*/
			<0x0>, /* NUM7 interrupt to CPU*/
			<0x0>, /* NUM7 access type*/
			<0x0>; /* NUM7 mode*/
		status = "okay";
	};
```

## linux-rt/Documentation/devicetree/bindings/soc/realtek/sb2-sem.txt
```
Reaktek SB2 Semaphore
=====================

Required properties:

- compatible :
        "realtek,sb2-sem", is required for all sb2 semaphore node, and
        "realtek,sb2-sem-dev" should be contained if a devfs should be
		created for the semaphore.

- reg : hall contain he semaphore address

Alias:
	hwsem

Example:
	alias {
		hwsem1 = &sb2_lock1;
	};

	sb2_lock0: sb2-lock@9801A000 {
		compatible = "realtek,sb2-sem";
		reg = <0x9801A000 0x4>;
	};

	sb2_lock1: sb2-lock@9801A620 {
		compatible = "realtek,sb2-sem", "realtek,sb2-sem-dev";
		reg = <0x9801A620 0x4>;
	};
```

## linux-rt/Documentation/devicetree/bindings/thermal/realtek-thermal.txt
```
Realtek Thermal Sensor 
======================

* Sensor node
-------------
Required properties :
- compatible : shall contain one of the following :
	"realtek,rtd119x-thermal-sensor",
	"realtek,rtd129x-thermal-sensor",
	"realtek,rtd139x-thermal-sensor",
	"realtek,rtd16xx-thermal-sensor".

- #thermal-sensor-cells : shall contain 0.

See also 'Documentation/devicetree/bindings/thermal/thermal.txt'

Exmaple :
	cpu-tsensor {
		tible = "realtek,rtd129x-thermal-sensor";
		reg = <0x9801D150 0x1C>;
		#thermal-sensor-cells = <0>;
		
		status = "okay";
	};
```

## linux-rt/arch/arm/mach-rtd139x/Kconfig
```kconfig
config ARCH_RTD139x
	bool "Realtek RTD139x family"
	select ARM_AMBA
	select ARM_GIC
	select ARM_GLOBAL_TIMER
	select CLKDEV_LOOKUP
	select ARCH_MULTI_V7
	select HAVE_SMP
	select HAVE_MACH_CLKDEV
	select GENERIC_CLOCKEVENTS
	select ZONE_DMA
	select HAVE_SCHED_CLOCK
	select ARCH_HAS_CPUFREQ
	select CLKSRC_OF
	select ARCH_REQUIRE_GPIOLIB
	select GENERIC_IRQ_CHIP
	select IRQ_DOMAIN
	select PINCTRL
	select COMMON_CLK
	select ARCH_HAS_BARRIERS
	select SPARSE_IRQ
	select RTK_PLATFORM
	select PM_OPP
	help
	  Support for Realtek RTD139x Platform
```

## linux-rt/drivers/gpu/drm/rtk/Kconfig
```kconfig
config DRM_RTK
	tristate "DRM Support for RTK display"
	depends on DRM
	select DRM_KMS_HELPER
    select DRM_KMS_FB_HELPER
    select DRM_KMS_CMA_HELPER
    select FB_RTK
	help
	  Choose this option for DRM support for the RTK display.
	  If M is selected the module will be called rtk_drm.
```

## linux-rt/drivers/media/platform/rtk_cvbsdetect/Kconfig
```kconfig
#Copyright (C) 2017 Realtek Semiconductor Corporation

config RTK_CVBS_SWITCH
	tristate "Realtek RTD1395 cvbs switch"
	select SWITCH
    select RTK_RPC
	help
	  enable CVBS detect feature on Realtek RTD1395 platform.
```

## linux-rt/drivers/media/platform/rtk_hdcptx/Kconfig
```kconfig
config RTK_HDCP_1x
	tristate "HDCP TX 1.x for Realtek RTD1295 platform"
	select I2C
	select SWITCH
	default n
	help
	  Say Y, if you want to enable HDCP TX 1.x feature on Realtek RTD1295 platform.
	  
config RTK_HDCP_1x_TEE
	tristate "HDCP TX 1.4 TEE for Realtek platform"
	select RTK_HDCP_1x
	select TEE
	default n
	---help---
	  Say Y, if you want to enable HDCP TX 1.4 TEE driver on Realtek platform.
```

## linux-rt/drivers/media/platform/rtk_hdmirx/Kconfig
```kconfig
config RTK_HDMIRX
	tristate "HDMIRX for Realtek RTD platform"
	select MEDIA_CAMERA_SUPPORT
	select VIDEO_DEV
	select I2C
	select VIDEO_V4L2
	select VIDEOBUF2_CORE
	select VIDEOBUF_GEN
	select VIDEOBUF2_VMALLOC
	select VIDEOBUF2_DMA_CONTIG
	default n
	---help---
	  Say Y, if you want to enable HDMI RX driver on Realtek RTD platform.

config RTK_HDCP1x_REPEATER
	tristate "HDCP 1.x Repeater for Realtek platform"
	select RTK_HDMIRX
    select RTK_HDCP_1x
	default n
	---help---
	  Say Y, if you want to enable HDCP 1.x repeater on Realtek platform.

config RTK_HDCPRX_1P4_TEE
	tristate "HDCP RX HDCP 1.4 TEE for Realtek platform"
	select TEE
	default n
	---help---
	  Say Y, if you want to enable HDCP RX 1.4 TEE driver on Realtek platform.

config RTK_HDCPRX_2P2
	tristate "HDCP RX 2.2 for Realtek platform"
	select RTK_HDMIRX
	default n
	---help---
		Say Y, if you want to enable HDCP RX 2.2 driver on Realtek platform.
```
