## linux-rt/drivers/net/irda/realtek/Kconfig
```kconfig
config RTK_IR
	tristate "Realtek IR Receiver Driver"
	default y
	help
		IR Receiver Character Device Driver
 
if RTK_IR
config SUPPORT_INPUT_DEVICE
	bool "Support IR Input Device"
	depends on RTK_IR
	default y
	help
	  IR Input Device Support

config SUPPORT_IRTX
	bool "Support IR TX"
	depends on RTK_IR
	default y
	help
	  IR TX Support

config YK_54LU
	bool "Support Skyworth TV Remote Controller"
	depends on RTK_IR
	default n
	help
	  Skyworth TV Remote Controller

config RTK_MK5_2
	bool "Support Realtek DTV Controller"
	depends on RTK_IR
	default n
	help
	  Realtek DTV Remote Controller
endif
```

## linux-rt/drivers/pinctrl/realtek/Kconfig
```kconfig
config PINCTRL_RTD119X
        bool "RTD119X pin controller driver"
        depends on ARCH_RTD119X
        default y
        select PINMUX
        select GENERIC_PINCONF

config PINCTRL_RTD129x
	bool "RTD129x pin controller driver"
	depends on ARCH_RTD129x
	default y
	select PINMUX
	select GENERIC_PINCONF

config PINCTRL_RTD139x
	bool "RTD139x pin controller driver"
	depends on ARCH_RTD139x
	default y
	select PINMUX
	select GENERIC_PINCONF

config PINCTRL_RTD16xx
	bool "RTD16xx pin controller driver"
	depends on ARCH_RTD16xx
	default y
	select PINMUX
	select GENERIC_PINCONF
```

## linux-rt/drivers/smartcard/Kconfig
```kconfig
# drivers/cec/Kconfig

menu "Smart Crad Interface Support"

config SMARTCARD
	tristate "Smart Card Interface Support"
	default n
	help
	  Say Y here if you want to support smart card on your platform 
	
source drivers/smartcard/core/Kconfig
source drivers/smartcard/adapter/Kconfig

endmenu
	
```

## linux-rt/drivers/smartcard/core/Kconfig
```kconfig
# drivers/smartcard/core/Kconfig
	
config SMARTCARD_CHARDEV
	bool "Smart Card Device Interface"
	depends on SMARTCARD
	select SMARTCARD_DEV_FILE
	help
	  Say Y here to use smart card device files, usually found in the /dev/smartcard/
	  directory on your system.  They make it possible to have user-space
	  programs use the smart card reader.	  
	
config SMARTCARD_DEV_FILE	
	bool
	depends on SMARTCARD
	default n

config SMARTCARD_DEBUG
	bool "Smart Card Debug Mode"
	depends on SMARTCARD
	default n
	help 
	  If you want to enable smart card debug message, say Y.
```

## linux-rt/drivers/soc/realtek/Kconfig
```kconfig
config RTD119X
        bool "Realtek RTD119X SoC family specific drivers"
        depends on ARCH_RTD119X
        default y
        help
          Realtek RTD119X SoC family specific support.

          If unsure, say N.

if RTD119X
source "drivers/soc/realtek/rtd119x/Kconfig"
source "drivers/soc/realtek/common/Kconfig"
endif

config RTD129x
	bool "Realtek RTD129x SoC family specific drivers"
	depends on ARCH_RTD129x
	default y
	help
	  Realtek RTD129x SoC family specific support.

	  If unsure, say N.

if RTD129x
source "drivers/soc/realtek/rtd129x/Kconfig"
source "drivers/soc/realtek/common/Kconfig"
endif # RTD129x

config RTD129x_FPGA
	bool "Realtek RTD129x FPGA"
	depends on ARCH_RTD129x
	select RTK_PLATFORM_FPGA
	default n
	help
	   FPGA without boot code.

config RTD139x
	bool "Realtek RTD139x SoC family specific drivers"
	depends on ARCH_RTD139x
	default y
	help
	  Realtek RTD139x SoC family specific support.

	  If unsure, say N.

if RTD139x
source "drivers/soc/realtek/rtd139x/Kconfig"
source "drivers/soc/realtek/common/Kconfig"
endif # RTD139x

config RTD139x_FPGA
	bool "Realtek RTD139x FPGA"
	depends on ARCH_RTD139x
	select RTK_PLATFORM_FPGA
	default n
	help
	   FPGA without boot code.

config RTD16xx
	bool "Realtek RTD16xx SoC family specific drivers"
	depends on ARCH_RTD16xx
	default y
	help
	  Realtek RTD16xx SoC family specific support.

	  If unsure, say N.

if RTD16xx
source "drivers/soc/realtek/rtd16xx/Kconfig"
source "drivers/soc/realtek/common/Kconfig"
endif # RTD16xx

config RTD16xx_FPGA
	bool "Realtek RTD16xx FPGA"
	depends on ARCH_RTD16xx
	select RTK_PLATFORM_FPGA
	default n
	help
	  FPGA without boot code.

config RTK_PLATFORM_FPGA
	def_bool n

config RTK_XEN_SUPPORT
	bool "Realtek XEN support"
	depends on XEN
	default n
	help
	  Realtek XEN utility support.

if RTK_XEN_SUPPORT
source "drivers/soc/realtek/xen/Kconfig"

endif
```

## linux-rt/drivers/soc/realtek/common/pwrctrl/Kconfig
```kconfig
menu "Power Control"

config POWER_CONTROL
	bool "Power Control Support"

config POWER_CONTROL_DEBUGFS
	bool "DebugFs for Power Control"
	depends on POWER_CONTROL
	default y if POWER_CONTROL

config POWER_CONTROL_REALTEK
	bool

config POWER_CONTROL_RTD129X
	bool "RTD129X SoC Power Controller"
	depends on POWER_CONTROL
	select PM_GENERIC_DOMAINS
	select POWER_CONTROL_REALTEK
	default y if ARCH_RTD129x
	help
	  Realtek RTD129x Soc Power Controller Driver.

config POWER_CONTROL_RTD139X
	bool "RTD139X SoC Power Controller"
	depends on POWER_CONTROL
	select PM_GENERIC_DOMAINS
	select POWER_CONTROL_REALTEK
	default y if ARCH_RTD139x
	help 
	  Realtek RTD139x Soc Power Controller Driver.

config POWER_CONTROL_RTD16XX
	bool "RTD16XX SoC Power Controller"
	depends on POWER_CONTROL
	select PM_GENERIC_DOMAINS
	select POWER_CONTROL_REALTEK
	default y if ARCH_RTD16xx
	help
	  Realtek RTD16xx Soc Power Controller Driver.
endmenu
```

## linux-rt/drivers/soc/realtek/rtd119x/Kconfig
```kconfig
comment "RTD119X Device Drivers"

menu "Realtek NAS support"
	depends on ARCH_RTD119X

config SENDFILE_PATCH
	bool "Reverse sendfile patch"
	default n
	help
	Use patched sendfile syscall to improve write performance on NAS.

endmenu

config SCPU_SRAMCTL_RTD119X
	bool "SCPU Wraper SRAM Control"
	default y if ARCH_RTD119X
```

## linux-rt/drivers/soc/realtek/rtd129x/Kconfig
```kconfig
menu "RTD129x Device Drivers"

config RTK_SW_LOCK_API
	bool "Realtek SW LOCK API"
	default y
	help
	  Realtek SW LOCK API driver

config RTK_FAN
	bool "Realtek Fan driver"
	default n
	help
	  Realtek Fan driver

source "drivers/soc/realtek/rtd129x/cwmp/Kconfig"
source "drivers/soc/realtek/rtd129x/rtk_ve/Kconfig"

endmenu #RTD129x Device Drivers
```
