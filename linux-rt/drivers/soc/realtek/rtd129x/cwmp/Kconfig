## linux-rtk/Documentation/devicetree/bindings/soc/realtek/hse.txt
```
Realtek HSE DT-binding
======================

* required properties:

- compatible: shall contain "realtek,highspeed-streaming-engine".

- reg: shall contain register address/size of demod.

- clocks: shall a clk phandle of hse.

See also Documentation/devicetree/bindings/clock/clock-bindings.txt

- resets: shall contain a reset control phandle of hse.

See also Documentation/devicetree/bindings/pinctrl/reset/reset.txt
```

## linux-rtk/Documentation/devicetree/bindings/soc/realtek/mmio.txt
```
Realtek MMIO db-bindings
========================

Required properties :
- compatible : shall contain only the following:
	"realtek,mmio"

- reg : shall contain the mmio address

Optional properties :
- realtek,sb2-lock : a phandle to sb2 sem, if not configured, only spinlock
	is used.

Exmaple:
	crt_mmio: mmio@98000000 {
		compatible = "realtek,mmio";
		reg = <0x98000000 0x600>;
		realtek,sb2-lock = <&sb2_lock0>;
	};
```

## linux-rtk/Documentation/devicetree/bindings/soc/realtek/power.txt
```
Realtek Power Control DT-bindings
=================================

Power Controller
----------------

* Required properities:

- compatible : shall contain the followings :
	"realtek,rtd129x-crt-power",
	"realtek,rtd139x-power-controller",
	"realtek,rtd16xx-power-controller",
	"realtek,rtd13xx-power-controller"

- reg : shall contain the base address of io memory. 

* Optional properities:

- #power-domain-cells : shall contain unsigned int 1, required if the
			power-controller is a power domain provider.

- #powerctrl-cells : shall contain unsigned int 1, required if
		     power-controller is a power control provider.
```

## linux-rtk/Documentation/devicetree/bindings/soc/realtek/r2rdsc.txt
```
Realtek R2RDSC DT-binding
=========================

* required properties:

- compatible: shall contain "realtek,r2rdsc".

- reg: shall contain register address/size of r2rdsc.

- clocks / clock-names: shall contain 2 clocks:
	"r2rdsc" for clk_en of r2rdsc.

  See also Documentation/devicetree/bindings/clock/clock-bindings.txt

- resets: shall contain 2 reset controls:
	"r2rdsc" for soft-reset of r2rdsc.

  See also Documentation/devicetree/bindings/pinctrl/reset/reset.txt


Example:

r2rdsc@9800b800 {
	compatible = "realtek,r2rdsc";
	reg = <0x0 0x9800b000 0x0 0x1000>;
	clocks = <&clk_en_4 CLK_EN_R2RDSC>;
	clock-names = "r2rdsc";
	resets = <&mux_rst0 RSTN_MUX_R2RDSC>;
	reset-names = "r2rdsc";
	status = "okay";
};
```

## linux-rtk/Documentation/devicetree/bindings/soc/realtek/tp.txt
```
Realtek TP DT-binding
========================

* required properties:

- compatible: shall contain "realtek,tp".

- reg: shall contain 2 register address/size of tp and tpb.

- clocks / clock-names: shall contain 2 clocks:
	"tp" for clk_en of tp,
	"tpb" for clk_en of tpb.

  See also Documentation/devicetree/bindings/clock/clock-bindings.txt

- resets: shall contain 2 reset controls:
	"tp" for soft-reset of tp,
	"tpb" for soft-reset of tpb.

  See also Documentation/devicetree/bindings/pinctrl/reset/reset.txt


Example:

tp@98014000 {
	compatible = "realtek,tp";
	reg = <0x0 0x98014000 0x0 0x1000>,
	<0x0 0x98039000 0x0 0x1000>;
	clocks = <&clk_en_2 CLK_EN_TP>, <&clk_en_2 CLK_EN_TPB>;
	clock-names = "tp", "tpb";
	resets = <&mux_rst0 RSTN_MUX_TP>, <&mux_rst0 RSTN_MUX_TPB>;
	reset-names = "tp", "tpb";
	status = "okay";
};
```

## linux-rtk/Documentation/devicetree/bindings/soc/realtek/uio_devices.txt
```
Realtek UIO devices dt-bindings
===============================

Required properties :

* reg : shall contain to address for a uio device

* compatible : shall contain the followings :
	"realtek,md" for MD,
	"realtek,se" for SE,
	"realtek,hse" for HSE,
	"realtek,uio" for Generic Uio Device,


Optional properties :

* clocks : shall contain the relative clock(s).

* resets : shall contain the relative reset(s).

* interrupts : shall contain the relative interrupt(s), which only supported
	by SE, MD, HSE.

Example:

	tp@98014000 {
		reg = <0x98014000 0x1000>;
		compatible = "realtek,uio";
		clocks = <&clk_en_1 CLK_EN_TP>;
		resets = <&rst1 RSTN_TP>;
		status = "okay";
	};
```

## linux-rtk/Documentation/devicetree/bindings/sound/realtek,audio-notifier.txt
```
Realtek Audio Notifier DT-bindings
----------------------------------

1 Common Properties

Required properties:

- compatible : shall contain 

	for an audio-in device:  "realtek,audio-in" with one of

		"alc5279", "wm8782", "adc" for an adc device, 
		"analog-in" for an analog-in device,
		"adc-amic" for an adc-amic device,

		if none, the audio-in device will be configured ad an adc device.

	"realtek,audio-out", for an audio-out device.

1.1 AI device

Required properties:

Optional properties:

- ai,type : shall contain "i2s" for a i2s deivce;

- ai,i2s-pin-shared: an empty property, indicates the i2s device is pin-shared.

- ai,i2s-master: an empty property, indicates the i2s device is a master-device.

1.1.1 Example 1:

	wm8782 {
		compatible = "realtek,audio-in", "wm8782";
		status = "okay";
	};

1.1.2 Example 2:

	i2s {
		compatible = "realtek,audio-in", "adc";
		status = "okay";

		ai,type = "i2s";
		ai,i2s-pin-shared;
		ai,i2s-master;
	};

1.2 AO device

Please add subnode(s) for each AO device.

1.2.1 Properties for a Subnode

Required properties:

- compatible : shall contain one of the followings:
	"dac",
	"spdif",
	"i2s",
	"hdmi",
	"global".

Optional properties:

- channel: only works when compatible is "i2s", shall contains a unsigned int,
	8 for 8 channels,
	others for 2 channels.

	default value is 2.

- slave-mode: only works when compatible is "i2s", a empty property, if this
	property exists, configure ao/i2s to slave mode. otherwise master mode.

1.2.2 Example :

	aodev {
		compatible = "realtek,audio-out";
		dac {
			compatible = "dac"
			status = "okay";
		};
		spdif {
			compatible = "spdif"
			status = "okay";
		};
		i2s {
			compatible = "i2s"
			status = "okay";
		};
		hdmi {
			compatible = "hdmi"
			status = "okay";
		};
		global {
			compatible = "global"
			status = "okay";
		};
	};
```
