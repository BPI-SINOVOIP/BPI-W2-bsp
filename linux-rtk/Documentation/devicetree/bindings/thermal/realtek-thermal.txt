## linux-rtk/drivers/soc/realtek/common/pwrctrl/Kconfig
```kconfig
menu "Power Control"

config POWER_CONTROL
	bool "Power Control Support"

config POWER_CONTROL_DEBUGFS
	bool "DebugFs for Power Control"
	depends on POWER_CONTROL
	default y if POWER_CONTROL

config POWER_CONTROL_REALTEK
	bool

config POWER_CONTROL_PD_SRAM
	bool

config POWER_CONTROL_PD_SRAM_CH
	bool

config POWER_CONTROL_PD_SIMPLE
	bool

config POWER_CONTROL_RTD129X
	bool "RTD129X SoC Power Controller"
	depends on POWER_CONTROL
	depends on ARCH_RTD129x
	select PM_GENERIC_DOMAINS
	select POWER_CONTROL_REALTEK
	select POWER_CONTROL_PD_SRAM
	select POWER_CONTROL_PD_SRAM_CH
	select POWER_CONTROL_PD_SIMPLE
	default y
	help
	  Realtek RTD129x Soc Power Controller Driver.

config POWER_CONTROL_RTD139X
	bool "RTD139X SoC Power Controller"
	depends on POWER_CONTROL
	depends on ARCH_RTD139x
	select PM_GENERIC_DOMAINS
	select POWER_CONTROL_REALTEK
	select POWER_CONTROL_PD_SRAM
	select POWER_CONTROL_PD_SIMPLE
	default y
	help
	  Realtek RTD139x Soc Power Controller Driver.

config POWER_CONTROL_RTD16XX
	bool "RTD16XX SoC Power Controller"
	depends on POWER_CONTROL
	depends on ARCH_RTD16xx
	select PM_GENERIC_DOMAINS
	select POWER_CONTROL_REALTEK
	select POWER_CONTROL_PD_SRAM
	select POWER_CONTROL_PD_SIMPLE
	default y
	help
	  Realtek RTD16xx Soc Power Controller Driver.

config POWER_CONTROL_RTD13XX
	bool "RTD13XX SoC Power Controller"
	depends on POWER_CONTROL
	depends on ARCH_RTD13xx
	select PM_GENERIC_DOMAINS
	select POWER_CONTROL_REALTEK
	select POWER_CONTROL_PD_SRAM
	select POWER_CONTROL_PD_SIMPLE
	default y
	help
	  Realtek RTD13xx Soc Power Controller Driver.

endmenu
```

## linux-rtk/drivers/soc/realtek/common/rpc/Kconfig
```kconfig
config RTK_RPC
	bool "Realtek RPC driver"
	depends on RTK_MEM_REMAP
	default y
	help
	  Realtek RPC driver with audio CPU
```

## linux-rtk/drivers/soc/realtek/rtd119x/rtk_ve/Kconfig
```kconfig
#
# Realtek codec configuration
#

menuconfig RTK_CODEC
	bool "Realtek Codec"
	default n

if RTK_CODEC

config RTK_RESERVE_MEMORY
	bool "RTK Reserve Memory for Video/Image Codec"
	default y

config VIDEO_CODEC
	bool "RTK Video Codec"
	default y

config IMAGE_CODEC
	bool "RTK Image Codec"
	default y

endif # RTK_CODEC
```

## linux-rtk/drivers/soc/realtek/rtd129x/hw_nat/Kconfig
```kconfig
menuconfig RTD_1295_HWNAT
	bool "Realtek HW NAT Driver"
	depends on NET
	select RTL_819X
	select RTL_8197F
	select 8198_PORT5_GMII
	select CPU_LITTLE_ENDIAN
	select RTL_819X_SWCORE
	select RTL_PROC_NEW
	select IP_VS
	default n
	---help---
	  You can say N here if you don't intend to use Realtek HW NAT at all.

	  You'll have to say Y if only HW NAT is used for your router.

	  If unsure, say N.

if RTD_1295_HWNAT

config RTL_819X
	bool
	default n

config RTL_8197F
	bool
	default y

config 8198_PORT5_GMII
	bool
	default n

config CPU_LITTLE_ENDIAN
	bool
	default n

config RTL_PROC_NEW
	bool
	default y

config RTL_8367R_SUPPORT
	bool
	default n

config RTL_8198C_8367RB
	bool
	default n

config RTL_8325D_SUPPORT
	bool
	default n

config RTL_SWITCH_NEW_DESCRIPTOR
	bool
	default n

config RTL_ETH_PRIV_SKB
	bool
	default n

config RTL_HW_TX_CSUM
	bool
	default n

config RTL_HTTP_REDIRECT
	bool
	default n

config RTL_HTTP_REDIRECT_LOCAL
	bool
	default n

config RTL_DNS_TRAP
	bool
	default n

config HARDWARE_NAT_DEBUG
	bool
	default n

config RTL_819X_SWCORE
	bool
	default y

config FPGA_V6_HWNAT
	bool
	default n

config DEFAULTS_KERNEL_2_6
	bool
	default y

config AUTO_DHCP_CHECK
	#bool "Auto DHCP Check"
	bool
	default n

config NEW_PCI
	bool
	default y
	depends on PCI

config RTL_IGMP_PROXY
	bool
	default n

config RTL_IGMP_SNOOPING
	bool
	default n
	depends on BRIDGE
	depends on !BRIDGE_IGMP_SNOOPING

config RTL_MLD_SNOOPING
	bool
	default n
	depends on RTL_IGMP_SNOOPING

config RTL_QUERIER_SELECTION
	bool
	default y
	depends on RTL_IGMP_SNOOPING

config RTL_MLD_PROXY
	bool
	default n

config RTL_LINKCHG_PROCESS
	bool
	default y

config RTL_DEBUG_TOOL
	bool
	default y

menu "Config for Layered Driver Features"
	config RTL_LAYERED_DRIVER
		bool
	        default y
		depends on RTL_819X

	config RTL_LAYERED_ASIC_DRIVER
		bool
		default n
		depends on RTL_LAYERED_DRIVER

	config RTL_LAYERED_ASIC_DRIVER_L3
		bool
		default n
		depends on RTL_LAYERED_ASIC_DRIVER

	config RTL_LAYERED_ASIC_DRIVER_L4
		bool
		default n
		depends on RTL_LAYERED_ASIC_DRIVER
		depends on RTL_8198 || RTL_8196CT || RTL_8198T || RTL_8198C || RTL_8197F

	config RTL_LAYERED_DRIVER_ACL
		bool
		default n
		depends on RTL_LAYERED_DRIVER

	config RTL_LAYERED_DRIVER_L2
		bool
		default n
		depends on RTL_LAYERED_DRIVER

	config RTL_HW_QOS_SUPPORT
		bool
		default n
		depends on RTL_LAYERED_DRIVER
		depends on RTL_8196CT || RTL_8198T || RTL_8198 || RTL_819XDT || RTL_8198C || RTL_8197F

	config RTL_LAYERED_DRIVER_L3
		bool
		default n
		depends on RTL_LAYERED_DRIVER


	config RTL_LAYERED_DRIVER_L4
		bool
		default n
		depends on RTL_LAYERED_DRIVER
		depends on RTL_8198 || RTL_8196CT || RTL_8198T || RTL_8198C || RTL_8197F

	comment 'Choose basic features.'

	config RTL_LINKCHG_PROCESS
		bool
		default n
		depends on RTL_LAYERED_DRIVER

	config RTL_EXTPORT_VLANID
		int
		default "9"
		depends on RTL_LAYERED_DRIVER

	comment 'Choose hardware features.'

	choice
		prompt "Hardware Features Selection"
		default RTL_HW_L2_ONLY
		depends on RTL_LAYERED_DRIVER

	config RTL_HW_NAPT
		bool "Enable RTL Hardware NAPT"
		depends on RTL_8198 || RTL_8196CT || RTL_8198T || RTL_819XDT || RTL_8367R_SUPPORT || RTL_89xxD || RTL_8196C || RTL_8196E || RTL_819XD || RTL_8198C || RTL_8197F
		select RTL_LAYERED_ASIC_DRIVER
		select RTL_LAYERED_ASIC_DRIVER_L3
		select RTL_LAYERED_ASIC_DRIVER_L4
		select RTL_LAYERED_DRIVER_ACL
		#select RTL_HW_QOS_SUPPORT
		select RTL_LAYERED_DRIVER_L2
		select RTL_LAYERED_DRIVER_L3
		select RTL_LAYERED_DRIVER_L4
		select RTL_HARDWARE_MULTICAST if RTL_IGMP_SNOOPING
		select RTL_HARDWARE_NAT

	config RTL_HW_MULTICAST_ONLY
		bool "Enable RTL Hardware Multicast Only"
		depends on !RTL_8370_SUPPORT
		select RTL_LAYERED_ASIC_DRIVER
		select RTL_LAYERED_ASIC_DRIVER_L3
		select RTL_LAYERED_DRIVER_ACL
		select RTL_LAYERED_DRIVER_L2
		select RTL_LAYERED_DRIVER_L3
		select RTL_HARDWARE_MULTICAST

	config RTL_HW_L2_ONLY
		bool "Enable RTL Hardware switch Only"
		select RTL_LAYERED_ASIC_DRIVER
		select RTL_LAYERED_DRIVER_ACL		#because mld snooping need add acl to trap ipv6 multicast packet to cpu
		select RTL_LAYERED_DRIVER_L2

	endchoice

	comment 'Choose advance features.'
#	config RTL_L2_HW_MULTICAST_SUPPORT
#		bool "RTL l2 hw multicast support"
#		default n
#		depends on RTL_HARDWARE_MULTICAST

	config RTL_HW_MCAST_PATCH_FOR_MAC
		#bool "RTL Hardware Multicast patch for Mac address"
		default y
		depends on RTL_HARDWARE_MULTICAST && !OPENWRT_SDK
		depends on RTL_8196E || RTL_8881A || RTL_8198C || RTL_8197F

	config RTL_HW_MCAST_WIFI
		bool "Support hw multiast for eth+wlan client"
		default y
		depends on RTL_HARDWARE_MULTICAST


	config RTL_EXT_PORT_SUPPORT
		bool "Enable extension port support"
		default n
		depends on RTL_HW_NAPT && !OPENWRT_SDK

	config RTL_CPU_TAG
		bool "Enable CPU tag"
		default n
		---help---
		Enable CPU tag between MAC0/MAC5 and external switch.
		Extra 4 bytes are inserted after SA MAC address in each packet.

	config RTL_WAN_MAC5
		bool "Set MAC5 as WAN port"
		default n
		---help---
		Disable original WAN (MAC4) port, and use MAC5 as WAN port.

	config RTL_2_RGMII_PORTS_ONLY
		bool "Set MAC5 as WAN port and MAC0 as LAN port"
		default n
		---help---
		Disable original WAN (MAC4) port.
		Use MAC5 as WAN port, and MAC0 as LAN port.

	config RTL_NETIF_MAPPING
		bool
		default y
		depends on RTL_LAYERED_DRIVER

	config RTL_MULTIPLE_WAN
		bool "Enable multiple wan in hw nat mode"
		default n
		depends on RTL_HARDWARE_NAT && !OPENWRT_SDK
		depends on RTL_8198T || RTL_8196CT || RTL_819XDT || RTL_8198C || RTL_8197F

	config RTL_IVL_SUPPORT
		bool "Support multi-vlan in bridge/wisp mode"
		default y
		depends on RTL_LAYERED_DRIVER && !RTL_8370_SUPPORT

	#config RTL_LOCAL_PUBLIC
	#	bool "Enable RTL local public"
	#	default n
	#	depends on RTL_HW_NAPT

	config RTL_HW_DSLITE_SUPPORT
		bool "Enable HW DS-LITE SUPPORT"
			default n
			depends on RTL_LAYERED_DRIVER && !OPENWRT_SDK
			depends on RTL_8198C || RTL_8197F
			depends on IPV6
			select IPV6_TUNNEL

	config RTL_HW_6RD_SUPPORT
		bool "Enable HW 6RD SUPPORT"
			default n
			depends on RTL_LAYERED_DRIVER && !OPENWRT_SDK
			depends on RTL_8198C || RTL_8197F
			depends on IPV6
			select IPV6_SIT
			select IPV6_SIT_6RD

	config RTL_TSO
		bool "Enable hardware TSO support(GSO is needed)"
		default y
		depends on RTL_8197F
		select RTL_GSO

	config RTL_GSO
		bool "Enable software GSO support"
		default y if RTL_8198C || RTL_819XD || RTL_8881A
		depends on RTL_8197F || RTL_8198C || RTL_819XD || RTL_8881A

endmenu

menu "Config Multicast Options"
	depends on RTL_IGMP_SNOOPING

	config RTL_PROCESS_PPPOE_IGMP_FOR_BRIDGE_FORWARD
		bool "IGMP/MLD Support for PPPoE Connection"
		#WE DON'T TURN ON THIS FEATURE WITHOUT TESTING.
		default n
endmenu

config RTL_IPTABLES_RULE_2_ACL
	bool "Enable iptables rule to RTL ACL rule"
	default n
	depends on RTL_LAYERED_DRIVER_ACL

config RTL865X_MBUF_HEADROOM
	int
	range 0 256
	default "128"
	depends on RTL_819X

config RTL_ETH_PRIV_SKB
	bool "Enable Ethernet Private Skb"
	default n
	depends on RTL_819X

config EXTRTL8212_PHYID_P1
	int
	default "18"
	depends on RTL_819X

config EXTRTL8212_PHYID_P3
	int
	default "20"
	depends on RTL_819X

config EXTRTL8212_PHYID_P5
	int
	default "22"
	depends on RTL_819X

config RTL_HW_NAPT_REFINE_KERNEL_HOOKS
	bool "Hw Nat Refine Kernel Hooks"
	default n
	depends on RTL_LAYERED_DRIVER
	depends on RTL_HARDWARE_NAT
	depends on OPENWRT_SDK
	depends on RTL_8196CT || RTL_8198T || RTL_8198 || RTL_819XDT || RTL_8196C || RTL_8196E || RTL_8198C ||RTL_8881A || RTL_8197F

config RTL_QOS_SYNC_SUPPORT
	bool "rtl qos sync hook support"
	depends on OPENWRT_SDK
	depends on RTL_IPTABLES_FAST_PATH ||RTL_HW_QOS_SUPPORT
	default y

config RTL_HW_QOS_DEBUG
	bool "rtl hw qos debug support"
	depends on OPENWRT_SDK
	depends on RTL_HW_QOS_SUPPORT
	default n

config RTL_HW_QOS_SUPPORT
	bool "Support HW Qos"
	default n
	depends on RTL_LAYERED_DRIVER
	depends on RTL_HARDWARE_NAT
	depends on RTL_8196CT || RTL_8198T || RTL_8198 || RTL_819XDT || RTL_8196C || RTL_8196E || RTL_8198C || RTL_8197F

config RTL_QOS_PATCH
	bool "HW QoS patch"
	default n
	depends on RTL_HW_QOS_SUPPORT

config RTL_HW_QOS_SUPPORT_WLAN
	bool "HW QoS Support Wlan Session"
	default n
	depends on RTL_HW_QOS_SUPPORT && !OPENWRT_SDK

config RTL_SW_QUEUE_DECISION_PRIORITY
	bool "HW QoS sw queue decision priority patch"
	default n
	depends on RTL_HW_QOS_SUPPORT && !OPENWRT_SDK

config RTL_HW_QOS_BRIDGE_FWD_SUPPORT
	bool "HW QoS bridge forward config support"
	default n
	depends on RTL_HW_QOS_SUPPORT

config RTL_8367_QOS_SUPPORT
	bool "Hw QoS support for 8367"
	default y
	depends on RTL_HW_QOS_SUPPORT && RTL_8367R_SUPPORT

config RTL_HARDWARE_MULTICAST
	bool
	default n
	depends on RTL_LAYERED_DRIVER
	depends on RTL_IGMP_SNOOPING

config RTL_HARDWARE_MULTICAST_CAM
    bool "HW multicast cam support"
	default n
	depends on RTL_LAYERED_DRIVER
	depends on RTL_HARDWARE_MULTICAST
#	depends on RTL_8196E || RTL_819XD

config RTL_HARDWARE_NAT
	bool
	default n
	depends on RTL_819X
	depends on RTL_8196CT || RTL_8198 || RTL8198T || RTL_8198C || RTL_8197F

config RTL_PPPOE_HWACC
	bool
	default y
	depends on RTL_HARDWARE_NAT

config RTL865X_HW_PPTPL2TP
	bool
	default n
	depends on RTL_HARDWARE_NAT

config RTL_IPV6READYLOGO
	bool "IPv6: ready logo patch"
	depends on IPV6
	default n

config RTL_HARDWARE_IPV6_SUPPORT
	bool "Enable hardware ipv6 support"
	default n
	depends on RTL_8198C || RTL_8197F
	depends on IPV6 && !OPENWRT_SDK

config RTL_PROC_DEBUG
	bool "Enable proc filesystem for debug"
	default y
	depends on RTL_819X

config RTL_JUMBO_FRAME
	bool "Enable JUMBO frame support"
	default n
	depends on RTL_819X && !OPENWRT_SDK

config RTL_UNKOWN_UNICAST_CONTROL
	bool
	default n
	depends on RTL_819X

config RTL_ENABLE_RATELIMIT_TABLE
	bool
	default y
	depends on RTL_UNKOWN_UNICAST_CONTROL

config RTL_MULTI_LAN_DEV
	bool "Multiple lan dev support"
	default y
	depends on (RTL_8198C || RTL_8197F) && !RTL_8021Q_VLAN_SUPPORT_SRC_TAG

config RTL_EEE_DISABLED
	bool "Disable 802.3az EEE feature"
	default n
	depends on RTL_819X && !RTL_8370_SUPPORT
#	depends on RTL_8196C || RTL_8198 || RTL_819XD || RTL_8196E || RTL_8881A

config RTL_ETH_802DOT1X_SUPPORT
	bool "Rtl ethernet 802.1x support"
	default n
	depends on RTL_819X
	depends on RTL_LAYERED_DRIVER

config RTL_ETH_802DOT1X_CLIENT_MODE_SUPPORT
	bool "Rtl ethernet 802.1x client mode support"
	default n
	depends on RTL_819X
	depends on RTL_LAYERED_DRIVER
	depends on RTL_ETH_802DOT1X_SUPPORT

# Realtek samba speed up
config RTL_USB_IP_HOST_SPEEDUP
	bool "rtl samba speedup"
	   default n
	depends on OPENWRT_SDK

config RTL_SENDFILE_PATCH
	bool "Enable reverse sendfile fastpath"
	default n
	depends on OPENWRT_SDK
	help
	  Improve performance on socket-to-file by using zero copy techonology.

config RTL_96E_GPIOB5_RESET
	bool "Enable GPIOB5 as Reset Button"
	default n
	depends on RTL_8196E

config RTL_GIGA_LITE_ENABLED
	bool "Enable Giga Lite support"
	default n
	depends on RTL_8198C
config RTL_REDIRECT_ACL_SUPPORT_FOR_ISP_MULTI_WAN
	bool "Enable redirect acl support for ISP multi wan"
	default n
	depends on RTL_ISP_MULTI_WAN_SUPPORT
	depends on RTL_HW_NAPT

#config RTL_IGMP_PROXY_MULTIWAN
#	bool "Enable igmpproxy for multi wan"
#	default n
#	depends on RTL_ISP_MULTI_WAN_SUPPORT
#	depends on RTL_IGMP_PROXY

#config RTL_ISP_MULTIPLE_BR_SUPPORT
#        bool "Enable multiple bridge support for igmp snooping"
#        default n
#        depends on RTL_ISP_MULTI_WAN_SUPPORT
#        depends on RTL_IGMP_SNOOPING

config RT_MULTIPLE_BR_SUPPORT
	bool
	default y
	depends on RTL_IGMP_SNOOPING && VLAN_8021Q
	depends on !OPENWRT_SDK

config RTL_BR_SHORTCUT
	bool "Enable bridge shortcut between LAN and WiFi"
	default n

config RTL_MULTICAST_PORT_MAPPING
	bool
	default y
	depends on RT_MULTIPLE_BR_SUPPORT

config RTD_1295_MAC0_SGMII_LINK_MON
	bool "Polling MAC0 link status"
	default n
	depends on RTD_1295_HWNAT
	---help---
	  You can say N here if you could get interrupt event when MAC0 link change.

	  You'll have to say Y if MDC/MDIO for MAC0 SGMII mode is broken.

	  If unsure, say Y.

config RTL_8211F_SUPPORT
	bool "Enable RTL8211F support"
	default n
	depends on RTL_8197F

config RTL_8367R_SUPPORT
	bool "Enable RTL8367RB support"
	default n
	depends on RTL_8197F || RTL_819XD || RTL_819XDT || RTL_8881A

config RTL_836X_SUPPORT
	bool "Enable RTL836X series support"
	default n
	depends on RTD_1295_HWNAT

config RTL_VLAN_8021Q
	bool "Make linux vlan support RTK router"
	default y
	depends on VLAN_8021Q
	help
	  Select this to make linux vlan support RTK router.
	  If unsure, say N.

config RTL_8021Q_VLAN_SUPPORT_SRC_TAG
	bool "Enable source tag support in linux vlan"
	default n
	depends on RTL_VLAN_8021Q
	help
	  Select this to make wan use source-lan tag in linux vlan.
	  If unsure, say N.

endif
#endmenu
#============================= End of Kconfig ===============================#
```
