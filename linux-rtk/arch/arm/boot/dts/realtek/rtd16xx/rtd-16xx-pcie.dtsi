/ {
	pcie: pcie@98060000 {
		compatible = "realtek,rtk16xx-pcie-slot1";
		reg = <0x0 0x98060000 0x0 0x00001000
		       0x0 0x98061000 0x0 0x00001000
		       0x0 0x9801C800 0x0 0x00000100
		       0x0 0x9801A000 0x0 0x00000300>;
		interrupt-names = "rtk-pcie1-intr";
		#interrupt-cells = <1>;
		interrupt-map-mask = <0 0 0 0>;
		interrupt-map = <0 0 0 0 &gic 0 0 GIC_SPI 61 IRQ_TYPE_LEVEL_HIGH>;
		pinctrl-names = "default";
		pinctrl-0 = <&pcie_clk_pins_0>;
		bus-range = <0x00 0xff>;
		linux,pci-domain = <0>;
		device_type = "pci";
		gpios = <&rtk_iso_gpio 29 1 0 >;
		#size-cells = <2>;
		#address-cells = <3>;
		num-lanes = <1>;
		phys =<0x00000003>,
		<0x40080001>,
		<0x2E000701>,
		<0x35910801>,
		<0x521C0901>,
		<0x7C421901>,
		<0x00011C01>,
		<0x32001D01>,
		<0x20EB1E01>,
		<0xF8001F01>,
		<0x3D402A01>,
		<0x81BD2F01>,
		<0x52F50401>,
		<0x27E90301>,
		<0xead70501>,
		<0x00080601>,
		<0xB6730a01>,
		<0x84552001>,
		<0x55552101>,
		<0xA85C0101>,
		<0x60420201>,
		<0xAB632301>,
		<0x080C2401>,
		<0xa8032b01>,
		<0x80A11B01>,
		<0x27e94301>,
		<0x52f54401>,
		<0xead74501>,
		<0x00064601>,
		<0x86734a01>,
		<0x84666001>,
		<0x55AA6101>,
		<0xa84a4101>,
		<0x60424201>,
		<0xAB636301>,
		<0x08106401>,
		<0xa8036b01>,
		<0xf8022801>,
		<0xf8026801>,
		<0x69050B01>,
		<0x69054B01>,
		<0xC0080C01>,
		<0xC0084C01>,
		<0xF7060D01>,
		<0xF7064D01>,
		<0x10000E01>,
		<0x10004E01>,
		<0x720C0901>,
		<0x700C0901>,
		<0x720C0901>,
		<0x720C4901>,
		<0x700C4901>,
		<0x720C4901>;

		//speed-mode = <1>; // 0:GEN1, 1:GEN2
		ranges = <0x02000000 0x00000000 0x98062000 0x0 0x98062000 0x00000000 0x0001E000
			0x01000000 0x00000000 0x00030000 0x0 0x00030000 0x00000000 0x00010000>;
		resets = <&crst RSTN_PCIE0>,
			<&crst RSTN_PCIE0_CORE>,
			<&crst RSTN_PCIE0_POWER>,
			<&crst RSTN_PCIE0_NONSTITCH>,
			<&crst RSTN_PCIE0_STITCH>,
			<&crst RSTN_PCIE0_PHY>,
			<&crst RSTN_PCIE0_PHY_MDIO>,
			<&crst RSTN_PCIE0_SGMII_MDIO>;

		reset-names = "rstn",
			"core",
			"power",
			"nonstitch",
			"stitch",
			"phy",
			"phy_mdio",
			"sgmii_mdio";
		clocks = <&clk_en_1 CLK_EN_PCIE0>;
		status = "okay";
	};

	pcie2: pcie2@980A0000 {
		compatible = "realtek,rtk16xx-pcie-slot2";
		reg = <0x0 0x980A0000 0x0 0x00001000
		       0x0 0x980A1000 0x0 0x00001000
		       0x0 0x9801C600 0x0 0x00000100
		       0x0 0x9804F000 0x0 0x00000100>;
		interrupt-names = "rtk-pcie2-intr";
		#interrupt-cells = <1>;
		interrupt-map-mask = <0 0 0 0>;
		interrupt-map = <0 0 0 0 &gic 0 0 GIC_SPI 62 IRQ_TYPE_LEVEL_HIGH>;
		pinctrl-names = "default";
		pinctrl-0 = <&pcie_clk_pins_1>;
		bus-range = <0x00 0xff>;
		linux,pci-domain = <1>;
		device_type = "pci";
		gpios = <&rtk_iso_gpio 65 1 0 >;
		#size-cells = <2>;
		#address-cells = <3>;
		num-lanes = <1>;
		phys =<0x00000003>,
		<0x40080001>,
		<0x2E000701>,
		<0x35910801>,
		<0x521C0901>,
		<0x7C421901>,
		<0x00011C01>,
		<0x32001D01>,
		<0x20EB1E01>,
		<0xF8001F01>,
		<0x3D402A01>,
		<0x81BD2F01>,
		<0x52F50401>,
		<0x27E90301>,
		<0xead70501>,
		<0x00080601>,
		<0xB6730a01>,
		<0x84552001>,
		<0x55552101>,
		<0xA85C0101>,
		<0x60420201>,
		<0xAB632301>,
		<0x080C2401>,
		<0xa8032b01>,
		<0x80A11B01>,
		<0x27e94301>,
		<0x52f54401>,
		<0xead74501>,
		<0x00064601>,
		<0x86734a01>,
		<0x84666001>,
		<0x55AA6101>,
		<0xa84a4101>,
		<0x60424201>,
		<0xAB636301>,
		<0x08106401>,
		<0xa8036b01>,
		<0xf8022801>,
		<0xf8026801>,
		<0x69050B01>,
		<0x69054B01>,
		<0xC0080C01>,
		<0xC0084C01>,
		<0xF7060D01>,
		<0xF7064D01>,
		<0x10000E01>,
		<0x10004E01>,
		<0x720C0901>,
		<0x700C0901>,
		<0x720C0901>,
		<0x720C4901>,
		<0x700C4901>,
		<0x720C4901>;

		//speed-mode = <1>; // 0:GEN1, 1:GEN2
		ranges = <0x02000000 0x00000000 0x980A2000 0x0 0x980A2000 0x00000000 0x0001E000
			0x01000000 0x00000000 0x00040000 0x0 0x00040000 0x00000000 0x00010000>;
		resets = <&crst RSTN_PCIE1>,
			<&crst RSTN_PCIE1_CORE>,
			<&crst RSTN_PCIE1_POWER>,
			<&crst RSTN_PCIE1_NONSTITCH>,
			<&crst RSTN_PCIE1_STITCH>,
			<&crst RSTN_PCIE1_PHY>,
			<&crst RSTN_PCIE1_PHY_MDIO>;

		reset-names = "rstn",
			"core",
			"power",
			"nonstitch",
			"stitch",
			"phy",
			"phy_mdio";
		clocks = <&clk_en_4 CLK_EN_PCIE1>;
		status = "okay";
	};
};
