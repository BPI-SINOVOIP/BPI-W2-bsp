## linux-rt/drivers/soc/realtek/rtd129x/cwmp/Kconfig
```kconfig
config RTK_CWMP_TREE
	tristate "Realtek CWMP support"
	default n
	help
	  Realtek CWMP Tree support.
```

## linux-rt/drivers/soc/realtek/rtd129x/rtk_ve/Kconfig
```kconfig
#
# Realtek codec configuration
#

menuconfig RTK_CODEC
	bool "Realtek Codec"
	default n

if RTK_CODEC

if ION
config RTK_RESERVE_MEMORY
	bool "RTK Reserve Memory for Video/Image Codec"
	default n
endif # ION

config VE1_CODEC
	bool "RTK Video Engine 1 Codec"
	default n

config VE3_CODEC
	bool "RTK Video Engine 3 Codec"
	default n

config IMAGE_CODEC
	bool "RTK Image Codec"
	default n

endif # RTK_CODEC
```

## linux-rt/drivers/soc/realtek/rtd139x/Kconfig
```kconfig
menu "RTD139x Device Drivers"

source "drivers/soc/realtek/rtd139x/rtk_ve/Kconfig"

endmenu #RTD139x Device Drivers
```

## linux-rt/drivers/xen/xenusb/Kconfig
```kconfig
config XEN_USBHOST_FRONTEND
	tristate "Xen USB-host irq frontend driver"
	depends on XEN
	default n
	help
	  Xen USB-host irq frontend driver

config XEN_USBHOST_BACKEND
	tristate "Xen USB-host irq backend driver"
	depends on XEN_BACKEND
	default n
	help
	  Xen USB-host irq backend driver
```

## linux-rtk/Documentation/devicetree/bindings/clock/realtek,clocks.txt
```
Realtek Clock Controller
========================

Clock controllers for Realtek Platform

--------------
Clock Provider
--------------

Required properties :
- compatible : shall contain only one of the following:

        "realtek,clock-controller" for Platform Clock Controller
	"realtek,tee-clock-controller" for TEE Clock Controller
        "realtek,clock-gate-controller" for Clock Gate Controller

- #clock-cells : shall contain 1

Must contain one of the following properties:

- reg : iomem address required

- realtek,mmio : referring to a regmap for iomem

Optional Properties of Clock Gate Controller :

- ignore-unused-clocks: shall contain a list of strings with clk_name in the
                        contoller, if a clock is in the list, the
                        CLK_IGNORE_UNUSED flags will be applied to the clock.

- ignore-pm-clocks: shall contain a list of strings with clk_name in the
                    contoller, if a clock is in the list, the clock will not
                    be managed in pm callbacks.

- has-write-en -or- realtek,hse-web: an bool property which indicates the
                                     controller to setup the gate clock with
                                     using write-en bit located in (gate_bit+1)

- clock-output-names: shall contain a list of strings of the clock name, to
                      be created. For those name with prefix 'unused', it
                      won't be created.

Example:

	cc: clock-controlller@98000000 {
		compatible   = "realtek,clock-controller";
		reg = <0x98000000 0x600>;
		#clock-cells = <1>;
		realtek,mmio = <&crt_mmio 0x0>;
	};

	tcc: tee-clocks {
		compatible   = "realtek,tee-clock-controller";
		#clock-cells = <0>;
	};

	ce1: clk-en@9800000c {
		compatible   = "realtek,clock-gate-controller";
		reg = <0x9800000c 0x4>;
		#clock-cells = <1>;
		realtek,cgc,id = <0>;
		realtek,mmio = <&crt_mmio 0xc>;
	};

--------------
Clock consumer
--------------
The clock id for clock-controller/clock-gate-contoller is defined in

        dt-bindings/clock/rtk,clock-rtd119x.h
        dt-bindings/clock/rtk,clock-rtd129x.h,
        dt-bindings/clock/rtk,clock-rtd139x.h,
        dt-bindings/clock/rtk,clock-rtd16xx.h,
        dt-bindings/clock/rtk,clock-rtd13xx.h.

Example:

	device {
		clocks = <&cc CC_PLL_SCPU>, <&ce1 CLK_EN_GPU>;
	};
```

## linux-rtk/Documentation/devicetree/bindings/cpufreq/cpufreq-rtk.txt
```
Realtek CPU Driver DT-bindings
==============================

DVFS node (platform device node)
-------------------------------

Required properties :
- compatible : shall contain only any of the following:
	"realtek,rtd129x-dvfs",
	"realtek,rtd139x-dvfs",
	"realtek,cpu-dvfs",
	"realtek,dummy-dvfs".

CPU node
--------

When using the dummy cpufreq driver, please put the following properties in the DVFS node.

- OPP binding:
  See also 'Documentation/devicetree/bindings/opp/opp.txt'

  Only support for operating-points-v2.

- CPU Cooling Dev binding (optional):
  See also 'Documentation/devicetree/bindings/thermal/thermal.txt'

- Clock binding:
  See also 'Documentation/devicetree/bindings/regulator/cpu.txt'

- Regulator binding (optional):
  See also 'Documentation/devicetree/bindings/regulator/regulator.txt'

Exmaple:
	cpus {
		cpu@0 {
			clocks = <&cc CC_PLL_SCPU>;
                        cpu-supply = <&cpu_supp>;
			operating-points-v2 = <&cpu_opps>;
			cooling-min-level = <0>;
			cooling-max-level = <11>;
			#cooling-cells = <2>; /* min followed by max */
		};
	};

	cpu_opps: opp-table-0 {
		...
	};

	dvfs {
		compatible = "realtek,rtk129x-dvfs";
	};
```

## linux-rtk/Documentation/devicetree/bindings/devfreq/realtek,busfreq.txt
```
Realtek Bus DFS DT-bindings
===========================

BUSFreq node
------------

Required properties :

- compatible : shall contain the following :
	"realtek,busfreq".

- operating-points-v2 : a phandle to a operating-points-v2.

- clocks : a phandle to bus clock

- devfreq-events: one or more phandles to devfreq event device(s).

- method: shall contain a string,
	"ltl" for long term load calculator,
	"passive" for passive.

- devfreq: only required when method is "passive", a phandle of a reference
	devfreq device.

Optional propertise :

- ltl-data: data for ltl governor


Bandwith Event node
-------------------

Required properties :

- compatible:  shall contain the following :
	"realtek,bw-event-dcsys", for a dcsys event,
	"realtek,bw-event-dmc", for a dmc event,

	and a fixed 2nd compatible

	"devfreq-event".

- perfcnts: shall contain a phandle to a perfcnt.


Example :

	event0: dcsys-bandwitdh-event {
		compatible = "realtek,bw-event-dcsys",
			"devfreq-event";
		perfcnts = <&pc0>;
		status = "okay";
	};

	event1: dmc-bandwitdh-event {
		compatible = "realtek,bw-event-dmc",
			"devfreq-event";
		perfcnts = <&pc1>;
		status = "okay";
	};

	dcsb-dfs {
		compatible = "realtek,busfreq";
		clocks = <&cc CC_PLL_DCSB>;
		devfreq-events = <&event0>, <&event1>;
		operating-points-v2 = <&dcsb_opps>;
		ltl-data = <0 0 0>;
		status = "okay";

		dcsb_opps: opp-table {
			compatible = "operating-points-v2";
			opp-low {
				opp-hz = /bits/ 64 <275000000>;
				clock-latency-ns = <150000>;
				suspend-opp;
			};
			opp-high {
				opp-hz = /bits/ 64 <550000000>;
				clock-latency-ns = <150000>;
			};
		};
	};
```

## linux-rtk/Documentation/devicetree/bindings/gpio/realtek,gpio.txt
```
- compatible: one of "realtek,rtk139x-iso-gpio-irq-mux", 
"realtek,rtk-misc-gpio-irq-mux","realtek,rtk-iso-gpio-irq-mux"
```

## linux-rtk/Documentation/devicetree/bindings/mfd/apw888x.txt
```
Anpec APW888X series PMIC DT-bindings
=====================================

Anpec APW888X serise PMIC contains the following sub devices:
	g22xx-powerkey,
	g22xx-poweroff,
	apw8889-regulator for Anpec APW8889,
	apw8886-regulator for Anper APW8886.

Sub nodes:

powerkey
--------
	This is compatible to g22xx-powerkey.
	See also Documentation/devicetree/bindings/mfd/g22xx.txt

poweroff
--------
	This is compatible to g22xx-poweroff.
	See also Documentation/devicetree/bindings/mfd/g22xx.txt

regulators
----------

Required properties:

* compatible: shall contains one of the following
	"anpec,apw8889-regulator",
	"anpec,apw8886-regulator".

See also Documentation/devicetree/bindings/regulator/regulator.txt.

Properties for sub nodes

Optional properties:

* apw888x-discharge-disable: disable discharge when suspend state is configured
	to regulator-off-in-suspend in the sub nodes
	regulator-state-mem/regulator-state-coldboot.

Example:

	&i2c_0 {
		status = "okay";

		apw8889: apw8889@12 {
			compatible = "anpec,apw8889";
			reg = <0x12>;
			status = "okay";

			powerkey: powerkey {
				compatible = "gmt,g22xx-powerkey";
				lp-handler = "sw";
				it-handler = "sw";
				time-sel = <0 0 3>;
				status = "okay";
			};
			poweroff: poweroff {
				compatible = "gmt,g22xx-poweroff";
				system-power-controller;
				status = "disabled";
			};
			regulators: regulators {
				compatible = "anpec,apw8889-regulator";
				status = "okay";
			};
		};
	};
```

## linux-rtk/Documentation/devicetree/bindings/mfd/g22xx.txt
```
GMT-G2227/G2237 PMIC DT-bindings
================================

G22XX series PMIC contains the following sub devices:
	g22xx-powerkey,
	g22xx-poweroff,
	g2227-regulator for G2227,
	g2237-regulator for G2237.

Sub nodes:


powerkey
--------

Optional propertise:

* lp-handler: a string, shall contains "hw", "sw", "off".
	use the configuration to handle longpress.

* it-handler: a string, shall contains "sw", "off".
	 use the configuration to handle short press event.

* time-sel: an integer array, shall contains 3 integer, time selection.
	<it-time, lp-time, lpoff-time>
	it-time
		0: 128ms
		1: 500ms
		2: 1000ms
		3: 1500ms
	lp-time
		0: 1s
		1: 2s
		2: 3s
		3: 4s
	lpoff-time
		0: 6s
		1: 7s
		2: 8s
		3: 10s

* lpoff-act: an integer, shall contains 0 or 1. specify which action to do
	when using hw lp-handler.
	0: reset
	1: nothing

poweroff
--------

Required properties:

	system-power-controller: a bool to indicate this device is a system
	power controller.

regulators
----------

Required properties:

* compatible: shall contains one of the following
	"gmt,g2227-regulator",
	"gmt,g2237-regulator".

	See also Documentation/devicetree/bindings/regulator/regulator.txt.

Example:

	&i2c_0 {
		status = "okay";

		g2237: g2237@12 {
			compatible = "gmt,g2237";
			reg = <0x12>;
			status = "okay";

			powerkey: powerkey {
				compatible = "gmt,g22xx-powerkey";
				lp-handler = "sw";
				it-handler = "sw";
				time-sel = <0 0 3>;
				status = "okay";
			};
			poweroff: poweroff {
				compatible = "gmt,g22xx-poweroff";
				system-power-controller;
				status = "disabled";
			};
			regulators: regulators {
				compatible = "gmt,g2237-regulator";
				status = "okay";
			};
		};
	};
```

## linux-rtk/Documentation/devicetree/bindings/pci/realtek-pcie.txt
```
- compatible: "realtek,rtk-pcie-slot1", "realtek,rtk-pcie-slot2" , "realtek,rtd139x-pcie"
```

## linux-rtk/Documentation/devicetree/bindings/regulator/realtek-pwm-regulator.txt
```
Bindings for the Realtek PWM Regulator
======================================

Required properties:


- compatible:     Shall contain "realtek,pwm-regulator".

- pwms:           PWM specification (See: ../pwm/pwm.txt)

- voltage-table:  Shall contain an array of triples with (voltage, duty, and period)

Optional properties:

Generic Regulator properties (See regulator.txt)

Example:

	cpu_supp: sy8089a-regulator {
		compatible = "realtek,pwm-regulator";
		pwms = <&pwm 2 75>;
		status = "okay";

		regulator-name = "sy8089a-0";
		regulator-min-microvolt = <800000>;
		regulator-max-microvolt = <1100000>;
		regulator-boot-on;
		regulator-always-on;

		voltage-table = <
			1100000    0   75
			1088000   76 1260
			1070000  152 1260
			1050000  227 1260
			1030000  303 1260
			1016000  378 1260
			 998000  454 1260
			 980000  530 1260
			 962000  605 1260
			 943000  688 1260
			 925000  744 1260
			 907000  819 1260
			 888000  895 1260
			 870000  971 1260
			 850000 1046 1260
			 833000 1122 1260
			 816000 1197 1260
			 800000 1260 1260
		>;
	};
```

## linux-rtk/Documentation/devicetree/bindings/reset/realtek,reset.txt
```
Realtek Reset Controller
========================

1. Generic Reset Controller

Required properties :

- compatible : shall contain:
	"realtek,reset-controller"

- #reset-cells: shall contain 1

- realtek,mmio: shall contain a phandle to mmio node and an offset.

Optional properties :

- async-group: contains an unsigned int. Only the groups with the same id,
	will be triggered when do_sync.

- no-pm: ingore the pm callbacks.

- boot-clear-bits : contains an unsigned int. A bit mask, which
        the register value will be clear.

- pm-ignore-bits: contains an unsigned int. A bit mask to tell which bits
	shall be ignored when restoring register value in pm callbacks.

- has-write-en: : an empty property which indicates the controlller to setup the reset bit with
	using write-en bit located in (reset_bit+1). (for Thor)

Example: 
	asr1: async-soft-reset@98000000 {
		compatible = "realtek,reset-controller";
		reg = <0x98000000 0x4>;
		realtek,mmio = <&crt_mmio 0x0>;
		#reset-cells = <1>;

		async-group = <0>;
		no-pm;
	};

	asr2: async-soft-reset@98000004 {
		compatible = "realtek,reset-controller";
		reg = <0x98000004 0x4>;
		realtek,mmio = <&crt_mmio 0x0>;
		#reset-cells = <1>;

		async-group = <0>;
		no-pm;
	};

	consumer {
		...
		resets = <&asr1 RTK_RSTN_DO_SYNC>,
			<&asr1 0>,
			<&asr2 1>;
	};


2. Platform Specific Reset Controller

Required properties :

- compatible : shall contain one of the following depended on the platform
	"realtek,rtd16xx-reset-controller",
	"realtek,rtd13xx-reset-controller"

- #reset-cells: shall contain 1

- realtek,mmio: shall contain a phandle to mmio node and an offset.

Example:
	crst: soft-reset@98000000 {
		compatible = "realtek,rtd16xx-reset-controller";
		reg = <0x0 0x98000000 0x0 0x1000>;
		#reset-cells = <1>;
		realtek,mmio = <&crt_mmio 0x0>;
	};
```

## linux-rtk/Documentation/devicetree/bindings/soc/realtek/dcsys_pc.txt
```
Realtek DCSYS PC dt-bindings
============================

Required properties :

* reg : shall contain to address of DCSYS

* compatible : shall contain the followings :
        "realtek,dcsys-pc".

* clocks: a phandle to reference

* clock-names: name of clock, shall be "ref".


Sub-Devices

-------------
Devfreq Event
-------------

Required properties :

* compatible : shall contain all of the followings :
	"realtek,dcsys-event",
	"devfreq-event".
---
UIO
---

Required properties :

* compatible : shall contain the followings :
	"realtek,dcsys-pc-uio".

Example:


        dcsys-pc@98008000 {
                compatible = "realtek,dcsys-pc", "simple-bus";
                reg = <0x98008000 0x1000>;
                clocks = <&cc CC_PLL_BUS_H>;
                clock-names = "ref";
                status = "okay";

                dcsys_event: event {
                        compatible = "realtek,dcsys-event", "devfreq-event";
                        status = "okay";
                };

                uio {
                        compatible = "realtek,dcsys-pc-uio";
                        status = "okay";
                };
        };
```

## linux-rtk/Documentation/devicetree/bindings/soc/realtek/demod.txt
```
Realtek Demod DT-binding
========================

* required properties:

- compatible: shall contain "realtek,demod".

- reg: shall contain register address/size of demod.

- clocks / clock-names: shall contain 2 clocks:
	"pll" for demod pll,
	"cablerx" for clk_en of demod.

  See also Documentation/devicetree/bindings/clock/clock-bindings.txt

- resets: shall contain a reset control of demod.

  See also Documentation/devicetree/bindings/pinctrl/reset/reset.txt

* optional properties:

- pinctrl-names / pinctrl-0: shall contain a pinctrl list of demod.

  See also Documentation/devicetree/bindings/pinctrl/pinctrl-bindings.txt

Example:

	demod@9801E000 {
		compatible = "realtek,demod";
		reg = <0x0 0x9801E000 0x0 0x1000>;
		clocks = <&clk_en_2 CLK_EN_CABLERX>, <&cc CC_PLL_DIF>;
		clock-names = "cablerx", "pll";
		resets = <&rst3 RSTN_CABLERX>;
		pinctrl-names = "default";
		pinctrl-0 = <&demod_pins>;
		status = "okay";
	};
```
