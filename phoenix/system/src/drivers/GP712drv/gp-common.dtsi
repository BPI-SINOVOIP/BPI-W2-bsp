
/ {
    spi_0: spi@9801BD00 {
        status = "okay";
    };

    rf4ce {
        compatible = "Realtek,rtk-rf4ce";
        gpios =
            <&rtk_misc_gpio 6 1 1>, /* chip sel, output, default high */
            <&rtk_iso_gpio 29 1 0>, /* RESETN, output, default low */
            <&rtk_iso_gpio 30 0 0>, /* INTOUTN, input, default N/A */
            <&rtk_misc_gpio 1 1 0>; /* WKUP, output, default low */
        ext_gpio_en = <1>; /* Use external GPIO pin ? 1: yes, 0: no */
        ext_wkup_pin = <6>; /* external GPIO pin for WKUP: 0~7 */
        status = "okay";
    };
};

